ASAP2_VERSION 1 71
/begin PROJECT AL551 "Audi AL551 / ZF 8HP TCU (Renesas SH72519, big-endian)"
/begin HEADER "AL551 tuning A2L - RE in ecus/al551 (CAN + control loops + cal maps)" VERSION "8R0927158AM_1003" /end HEADER
/begin MODULE AL551 "ZF 8HP45/8HP55 TCU; Q5/SQ5 3.0T; SW1003"
/begin MOD_COMMON "big-endian SH-2A, byte-aligned" BYTE_ORDER MSB_FIRST ALIGNMENT_BYTE 1 ALIGNMENT_WORD 2 ALIGNMENT_LONG 4 /end MOD_COMMON
/begin MOD_PAR "flash/RAM layout (bri3d VW_Flash#123 + SH72519 map)" /* CAL CRC32 over 0x190000..0x1FFD5F stored at 0x180244 */
 /begin MEMORY_SEGMENT RESERVED_boot "RESERVED" RESERVED FLASH INTERN 0x0 0x40000 -1 -1 -1 -1 -1 /end MEMORY_SEGMENT
 /begin MEMORY_SEGMENT CODE_asw "CODE" CODE FLASH INTERN 0x40080 0x13FAF0 -1 -1 -1 -1 -1 /end MEMORY_SEGMENT
 /begin MEMORY_SEGMENT CODE_boot2 "CODE" CODE FLASH INTERN 0x180280 0xFD80 -1 -1 -1 -1 -1 /end MEMORY_SEGMENT
 /begin MEMORY_SEGMENT DATA_cal "DATA" DATA FLASH INTERN 0x190000 0x6FD60 -1 -1 -1 -1 -1 /end MEMORY_SEGMENT
 /begin MEMORY_SEGMENT RAM_signals "DATA" DATA RAM INTERN 0xFFF80000 0x40000 -1 -1 -1 -1 -1 /end MEMORY_SEGMENT
/end MOD_PAR
/begin COMPU_METHOD CM_IDENT "identity" IDENTICAL "%.0f" "" /end COMPU_METHOD
/begin COMPU_METHOD CM_RAW "raw byte" IDENTICAL "%.0f" "-" /end COMPU_METHOD
/begin COMPU_METHOD CM_RPM "engine/turbine speed" IDENTICAL "%.0f" "rpm" /end COMPU_METHOD
/begin COMPU_METHOD CM_KMH "vehicle speed" LINEAR "%.2f" "km/h" COEFFS_LINEAR 0.01 0 /end COMPU_METHOD
/begin COMPU_METHOD CM_NM "torque" IDENTICAL "%.0f" "Nm" /end COMPU_METHOD
/begin COMPU_METHOD CM_PCT "throttle/load" IDENTICAL "%.1f" "%" /end COMPU_METHOD
/begin RECORD_LAYOUT RL_U8 FNC_VALUES 1 UBYTE ROW_DIR DIRECT /end RECORD_LAYOUT
/begin RECORD_LAYOUT RL_U16 FNC_VALUES 1 UWORD ROW_DIR DIRECT /end RECORD_LAYOUT
/begin RECORD_LAYOUT RL_U32 FNC_VALUES 1 ULONG ROW_DIR DIRECT /end RECORD_LAYOUT
/begin RECORD_LAYOUT RL_S16 FNC_VALUES 1 SWORD ROW_DIR DIRECT /end RECORD_LAYOUT
/begin RECORD_LAYOUT RL_AXIS_U16 AXIS_PTS_X 1 UWORD INDEX_INCR DIRECT /end RECORD_LAYOUT
/begin RECORD_LAYOUT RL_CURVE_U16 FNC_VALUES 1 UWORD ROW_DIR DIRECT /end RECORD_LAYOUT
/begin RECORD_LAYOUT RL_MAP_U16 FNC_VALUES 1 UWORD COLUMN_DIR DIRECT /end RECORD_LAYOUT
/* shared shift-curve input axis [1340 2015 3000 3770 4885 6300 7500] rpm */
/begin AXIS_PTS AX_shift_rpm "shift input rpm axis (7pt)" 0x1d3330 NO_INPUT_QUANTITY RL_AXIS_U16 0 CM_RPM 7 0 8000 /end AXIS_PTS
/* torque-limit engine-input-torque column axis (8pt, 0..600 Nm) */
/begin AXIS_PTS AX_tq_col "engine input torque axis (Nm)" 0x1b0c10 NO_INPUT_QUANTITY RL_AXIS_U16 0 CM_NM 8 0 600 /end AXIS_PTS
/begin AXIS_PTS AX_tq_row "torque-map row axis (10pt)" 0x1b0bf8 NO_INPUT_QUANTITY RL_AXIS_U16 0 CM_IDENT 10 0 4096 /end AXIS_PTS
/* ---- CAN RX 8-byte frame buffers (on-chip RAM) ---- */
/begin MEASUREMENT CANRX_buf_0x4c "CAN RX frame buffer msg_index 0x4c" UBYTE CM_RAW 0 0 0 255 ECU_ADDRESS 0xfff91ae8 MATRIX_DIM 8 /end MEASUREMENT
/begin MEASUREMENT CANRX_buf_0x4d "CAN RX frame buffer msg_index 0x4d" UBYTE CM_RAW 0 0 0 255 ECU_ADDRESS 0xfff91af0 MATRIX_DIM 8 /end MEASUREMENT
/begin MEASUREMENT CANRX_buf_0x4e "CAN RX frame buffer msg_index 0x4e" UBYTE CM_RAW 0 0 0 255 ECU_ADDRESS 0xfff91b08 MATRIX_DIM 8 /end MEASUREMENT
/begin MEASUREMENT CANRX_buf_0x4f "CAN RX frame buffer msg_index 0x4f" UBYTE CM_RAW 0 0 0 255 ECU_ADDRESS 0xfff91b10 MATRIX_DIM 8 /end MEASUREMENT
/begin MEASUREMENT CANRX_buf_0x50 "CAN RX frame buffer msg_index 0x50" UBYTE CM_RAW 0 0 0 255 ECU_ADDRESS 0xfff91b18 MATRIX_DIM 8 /end MEASUREMENT
/begin MEASUREMENT CANRX_buf_0x51 "CAN RX frame buffer msg_index 0x51" UBYTE CM_RAW 0 0 0 255 ECU_ADDRESS 0xfff91b28 MATRIX_DIM 8 /end MEASUREMENT
/begin MEASUREMENT CANRX_buf_0x52 "CAN RX frame buffer msg_index 0x52" UBYTE CM_RAW 0 0 0 255 ECU_ADDRESS 0xfff91b30 MATRIX_DIM 8 /end MEASUREMENT
/begin MEASUREMENT CANRX_buf_0x53 "CAN RX frame buffer msg_index 0x53" UBYTE CM_RAW 0 0 0 255 ECU_ADDRESS 0xfff91b38 MATRIX_DIM 8 /end MEASUREMENT
/begin MEASUREMENT CANRX_buf_0x54 "CAN RX frame buffer msg_index 0x54" UBYTE CM_RAW 0 0 0 255 ECU_ADDRESS 0xfff91b40 MATRIX_DIM 8 /end MEASUREMENT
/begin MEASUREMENT CANRX_buf_0x55 "CAN RX frame buffer msg_index 0x55" UBYTE CM_RAW 0 0 0 255 ECU_ADDRESS 0xfff91b48 MATRIX_DIM 8 /end MEASUREMENT
/begin MEASUREMENT CANRX_buf_0x56 "CAN RX frame buffer msg_index 0x56" UBYTE CM_RAW 0 0 0 255 ECU_ADDRESS 0xfff91b50 MATRIX_DIM 8 /end MEASUREMENT
/begin MEASUREMENT CANRX_buf_0x57 "CAN RX frame buffer msg_index 0x57" UBYTE CM_RAW 0 0 0 255 ECU_ADDRESS 0xfff91b58 MATRIX_DIM 8 /end MEASUREMENT
/begin MEASUREMENT CANRX_buf_0x58 "CAN RX frame buffer msg_index 0x58" UBYTE CM_RAW 0 0 0 255 ECU_ADDRESS 0xfff91b60 MATRIX_DIM 8 /end MEASUREMENT
/begin MEASUREMENT CANRX_buf_0x59 "CAN RX frame buffer msg_index 0x59" UBYTE CM_RAW 0 0 0 255 ECU_ADDRESS 0xfff91b68 MATRIX_DIM 8 /end MEASUREMENT
/begin MEASUREMENT CANRX_buf_0x5a "CAN RX frame buffer msg_index 0x5a" UBYTE CM_RAW 0 0 0 255 ECU_ADDRESS 0xfff91b70 MATRIX_DIM 8 /end MEASUREMENT
/begin MEASUREMENT CANRX_buf_0x5b "CAN RX frame buffer msg_index 0x5b" UBYTE CM_RAW 0 0 0 255 ECU_ADDRESS 0xfff91b78 MATRIX_DIM 8 /end MEASUREMENT
/begin MEASUREMENT CANRX_buf_0x5c "CAN RX frame buffer msg_index 0x5c" UBYTE CM_RAW 0 0 0 255 ECU_ADDRESS 0xfff91b80 MATRIX_DIM 8 /end MEASUREMENT
/begin MEASUREMENT CANRX_buf_0x5d "CAN RX frame buffer msg_index 0x5d" UBYTE CM_RAW 0 0 0 255 ECU_ADDRESS 0xfff91b88 MATRIX_DIM 8 /end MEASUREMENT
/begin MEASUREMENT CANRX_buf_0x5e "CAN RX frame buffer msg_index 0x5e" UBYTE CM_RAW 0 0 0 255 ECU_ADDRESS 0xfff91b90 MATRIX_DIM 8 /end MEASUREMENT
/begin MEASUREMENT CANRX_buf_0x5f "CAN RX frame buffer msg_index 0x5f" UBYTE CM_RAW 0 0 0 255 ECU_ADDRESS 0xfff91b98 MATRIX_DIM 8 /end MEASUREMENT
/begin MEASUREMENT CANRX_buf_0x60 "CAN RX frame buffer msg_index 0x60" UBYTE CM_RAW 0 0 0 255 ECU_ADDRESS 0xfff91ba0 MATRIX_DIM 8 /end MEASUREMENT
/begin MEASUREMENT CANRX_buf_0x61 "CAN RX frame buffer msg_index 0x61" UBYTE CM_RAW 0 0 0 255 ECU_ADDRESS 0xfff91ba8 MATRIX_DIM 8 /end MEASUREMENT
/begin MEASUREMENT CANRX_buf_0x62 "CAN RX frame buffer msg_index 0x62" UBYTE CM_RAW 0 0 0 255 ECU_ADDRESS 0xfff91bb0 MATRIX_DIM 8 /end MEASUREMENT
/begin MEASUREMENT CANRX_buf_0x01 "CAN RX frame buffer msg_index 0x01" UBYTE CM_RAW 0 0 0 255 ECU_ADDRESS 0xfff91bb8 MATRIX_DIM 8 /end MEASUREMENT
/* ---- CAN TX frame buffers ---- */
/begin MEASUREMENT CANTX_Getriebe_01 "TX frame 0x082 Getriebe_01" UBYTE CM_RAW 0 0 0 255 ECU_ADDRESS 0xfff91c88 MATRIX_DIM 8 /end MEASUREMENT
/begin MEASUREMENT CANTX_Getriebe_02 "TX frame 0x083 Getriebe_02" UBYTE CM_RAW 0 0 0 255 ECU_ADDRESS 0xfff91cb0 MATRIX_DIM 8 /end MEASUREMENT
/begin MEASUREMENT CANTX_WBA_01 "TX frame 0x390 WBA_01" UBYTE CM_RAW 0 0 0 255 ECU_ADDRESS 0xfff91e60 MATRIX_DIM 4 /end MEASUREMENT
/* ---- traced control-loop RAM signals ---- */
/begin MEASUREMENT CHARISMA_FahrPr_latched "Latched drive program, echoed Getriebe_04" UBYTE CM_IDENT 0 0 0 255 ECU_ADDRESS 0xfff95175 /end MEASUREMENT
/begin MEASUREMENT CHARISMA_FahrPr_input "Drive-program input from Charisma_01(0x385)" UBYTE CM_IDENT 0 0 0 255 ECU_ADDRESS 0xfff95172 /end MEASUREMENT
/begin MEASUREMENT CHARISMA_FahrPr_rx "Decoded Charisma_01 drive-program byte" UBYTE CM_IDENT 0 0 0 255 ECU_ADDRESS 0xfff89454 /end MEASUREMENT
/begin MEASUREMENT TorqueLimit_result_0 "Input-torque-limit map result cell 0" UWORD CM_NM 0 0 0 65535 ECU_ADDRESS 0xfff8c814 /end MEASUREMENT
/begin MEASUREMENT TorqueLimit_result_1 "Input-torque-limit map result cell 1" UWORD CM_NM 0 0 0 65535 ECU_ADDRESS 0xfff8c81c /end MEASUREMENT
/begin MEASUREMENT TorqueLimit_result_2 "Input-torque-limit map result cell 2" UWORD CM_NM 0 0 0 65535 ECU_ADDRESS 0xfff8c824 /end MEASUREMENT
/begin MEASUREMENT TCU_OutputShaftSpeed "Output-shaft speed (gear-ratio numerator)" UWORD CM_RPM 0 0 0 65535 ECU_ADDRESS 0xfff95524 /end MEASUREMENT
/begin MEASUREMENT TCU_InputSpeed_gear "Per-gear input/turbine speed (6 words 0xfff95518..22)" UWORD CM_RPM 0 0 0 65535 ECU_ADDRESS 0xfff95518 /end MEASUREMENT
/* ==== TUNABLE: input-torque-limit Kennfelder (gear x mode selected) ==== */
/begin CHARACTERISTIC TQLIM_1b0bf4 "input-torque limit Nm @0x1b0bf4 (10x8 grid)" MAP 0x1b0c20 RL_MAP_U16 0 CM_NM 0 4950
 /begin AXIS_DESCR COM_AXIS NO_INPUT_QUANTITY CM_NM 8 0 600 AXIS_PTS_REF AX_tq_col /end AXIS_DESCR
 /begin AXIS_DESCR COM_AXIS NO_INPUT_QUANTITY CM_IDENT 10 0 4096 AXIS_PTS_REF AX_tq_row /end AXIS_DESCR
/end CHARACTERISTIC
/begin CHARACTERISTIC TQLIM_1b0cc0 "input-torque limit Nm @0x1b0cc0 (10x8 grid)" MAP 0x1b0cec RL_MAP_U16 0 CM_NM 0 4950
 /begin AXIS_DESCR COM_AXIS NO_INPUT_QUANTITY CM_NM 8 0 600 AXIS_PTS_REF AX_tq_col /end AXIS_DESCR
 /begin AXIS_DESCR COM_AXIS NO_INPUT_QUANTITY CM_IDENT 10 0 4096 AXIS_PTS_REF AX_tq_row /end AXIS_DESCR
/end CHARACTERISTIC
/begin CHARACTERISTIC TQLIM_1b0d8c "input-torque limit Nm @0x1b0d8c (10x8 grid)" MAP 0x1b0db8 RL_MAP_U16 0 CM_NM 0 4950
 /begin AXIS_DESCR COM_AXIS NO_INPUT_QUANTITY CM_NM 8 0 600 AXIS_PTS_REF AX_tq_col /end AXIS_DESCR
 /begin AXIS_DESCR COM_AXIS NO_INPUT_QUANTITY CM_IDENT 10 0 4096 AXIS_PTS_REF AX_tq_row /end AXIS_DESCR
/end CHARACTERISTIC
/begin CHARACTERISTIC TQLIM_1b0e58 "input-torque limit Nm @0x1b0e58 (10x8 grid)" MAP 0x1b0e84 RL_MAP_U16 0 CM_NM 0 4950
 /begin AXIS_DESCR COM_AXIS NO_INPUT_QUANTITY CM_NM 8 0 600 AXIS_PTS_REF AX_tq_col /end AXIS_DESCR
 /begin AXIS_DESCR COM_AXIS NO_INPUT_QUANTITY CM_IDENT 10 0 4096 AXIS_PTS_REF AX_tq_row /end AXIS_DESCR
/end CHARACTERISTIC
/begin CHARACTERISTIC TQLIM_1b0f24 "input-torque limit Nm @0x1b0f24 (10x8 grid)" MAP 0x1b0f50 RL_MAP_U16 0 CM_NM 0 4950
 /begin AXIS_DESCR COM_AXIS NO_INPUT_QUANTITY CM_NM 8 0 600 AXIS_PTS_REF AX_tq_col /end AXIS_DESCR
 /begin AXIS_DESCR COM_AXIS NO_INPUT_QUANTITY CM_IDENT 10 0 4096 AXIS_PTS_REF AX_tq_row /end AXIS_DESCR
/end CHARACTERISTIC
/begin CHARACTERISTIC TQLIM_1b0ff0 "input-torque limit Nm @0x1b0ff0 (10x8 grid)" MAP 0x1b101c RL_MAP_U16 0 CM_NM 0 4950
 /begin AXIS_DESCR COM_AXIS NO_INPUT_QUANTITY CM_NM 8 0 600 AXIS_PTS_REF AX_tq_col /end AXIS_DESCR
 /begin AXIS_DESCR COM_AXIS NO_INPUT_QUANTITY CM_IDENT 10 0 4096 AXIS_PTS_REF AX_tq_row /end AXIS_DESCR
/end CHARACTERISTIC
/begin CHARACTERISTIC TQLIM_1b1330 "input-torque limit Nm @0x1b1330 (10x8 grid)" MAP 0x1b135c RL_MAP_U16 0 CM_NM 0 4950
 /begin AXIS_DESCR COM_AXIS NO_INPUT_QUANTITY CM_NM 8 0 600 AXIS_PTS_REF AX_tq_col /end AXIS_DESCR
 /begin AXIS_DESCR COM_AXIS NO_INPUT_QUANTITY CM_IDENT 10 0 4096 AXIS_PTS_REF AX_tq_row /end AXIS_DESCR
/end CHARACTERISTIC
/begin CHARACTERISTIC TQLIM_1b13fc "input-torque limit Nm @0x1b13fc (10x8 grid)" MAP 0x1b1428 RL_MAP_U16 0 CM_NM 0 4950
 /begin AXIS_DESCR COM_AXIS NO_INPUT_QUANTITY CM_NM 8 0 600 AXIS_PTS_REF AX_tq_col /end AXIS_DESCR
 /begin AXIS_DESCR COM_AXIS NO_INPUT_QUANTITY CM_IDENT 10 0 4096 AXIS_PTS_REF AX_tq_row /end AXIS_DESCR
/end CHARACTERISTIC
/begin CHARACTERISTIC TQLIM_1b14c8 "input-torque limit Nm @0x1b14c8 (10x8 grid)" MAP 0x1b14f4 RL_MAP_U16 0 CM_NM 0 4950
 /begin AXIS_DESCR COM_AXIS NO_INPUT_QUANTITY CM_NM 8 0 600 AXIS_PTS_REF AX_tq_col /end AXIS_DESCR
 /begin AXIS_DESCR COM_AXIS NO_INPUT_QUANTITY CM_IDENT 10 0 4096 AXIS_PTS_REF AX_tq_row /end AXIS_DESCR
/end CHARACTERISTIC
/begin CHARACTERISTIC TQLIM_1b1594 "input-torque limit Nm @0x1b1594 (10x8 grid)" MAP 0x1b15c0 RL_MAP_U16 0 CM_NM 0 4950
 /begin AXIS_DESCR COM_AXIS NO_INPUT_QUANTITY CM_NM 8 0 600 AXIS_PTS_REF AX_tq_col /end AXIS_DESCR
 /begin AXIS_DESCR COM_AXIS NO_INPUT_QUANTITY CM_IDENT 10 0 4096 AXIS_PTS_REF AX_tq_row /end AXIS_DESCR
/end CHARACTERISTIC
/begin CHARACTERISTIC TQLIM_1b1660 "input-torque limit Nm @0x1b1660 (10x8 grid)" MAP 0x1b168c RL_MAP_U16 0 CM_NM 0 4950
 /begin AXIS_DESCR COM_AXIS NO_INPUT_QUANTITY CM_NM 8 0 600 AXIS_PTS_REF AX_tq_col /end AXIS_DESCR
 /begin AXIS_DESCR COM_AXIS NO_INPUT_QUANTITY CM_IDENT 10 0 4096 AXIS_PTS_REF AX_tq_row /end AXIS_DESCR
/end CHARACTERISTIC
/begin CHARACTERISTIC TQLIM_1b172c "input-torque limit Nm @0x1b172c (10x8 grid)" MAP 0x1b1758 RL_MAP_U16 0 CM_NM 0 4950
 /begin AXIS_DESCR COM_AXIS NO_INPUT_QUANTITY CM_NM 8 0 600 AXIS_PTS_REF AX_tq_col /end AXIS_DESCR
 /begin AXIS_DESCR COM_AXIS NO_INPUT_QUANTITY CM_IDENT 10 0 4096 AXIS_PTS_REF AX_tq_row /end AXIS_DESCR
/end CHARACTERISTIC
/begin CHARACTERISTIC TQLIM_1b18a4 "input-torque limit Nm @0x1b18a4 (10x8 grid)" MAP 0x1b18d0 RL_MAP_U16 0 CM_NM 0 4950
 /begin AXIS_DESCR COM_AXIS NO_INPUT_QUANTITY CM_NM 8 0 600 AXIS_PTS_REF AX_tq_col /end AXIS_DESCR
 /begin AXIS_DESCR COM_AXIS NO_INPUT_QUANTITY CM_IDENT 10 0 4096 AXIS_PTS_REF AX_tq_row /end AXIS_DESCR
/end CHARACTERISTIC
/begin CHARACTERISTIC TQLIM_1b1970 "input-torque limit Nm @0x1b1970 (10x8 grid)" MAP 0x1b199c RL_MAP_U16 0 CM_NM 0 4950
 /begin AXIS_DESCR COM_AXIS NO_INPUT_QUANTITY CM_NM 8 0 600 AXIS_PTS_REF AX_tq_col /end AXIS_DESCR
 /begin AXIS_DESCR COM_AXIS NO_INPUT_QUANTITY CM_IDENT 10 0 4096 AXIS_PTS_REF AX_tq_row /end AXIS_DESCR
/end CHARACTERISTIC
/begin CHARACTERISTIC TQLIM_1b1a3c "input-torque limit Nm @0x1b1a3c (10x8 grid)" MAP 0x1b1a68 RL_MAP_U16 0 CM_NM 0 4950
 /begin AXIS_DESCR COM_AXIS NO_INPUT_QUANTITY CM_NM 8 0 600 AXIS_PTS_REF AX_tq_col /end AXIS_DESCR
 /begin AXIS_DESCR COM_AXIS NO_INPUT_QUANTITY CM_IDENT 10 0 4096 AXIS_PTS_REF AX_tq_row /end AXIS_DESCR
/end CHARACTERISTIC
/begin CHARACTERISTIC TQLIM_1b1b08 "input-torque limit Nm @0x1b1b08 (10x8 grid)" MAP 0x1b1b34 RL_MAP_U16 0 CM_NM 0 4950
 /begin AXIS_DESCR COM_AXIS NO_INPUT_QUANTITY CM_NM 8 0 600 AXIS_PTS_REF AX_tq_col /end AXIS_DESCR
 /begin AXIS_DESCR COM_AXIS NO_INPUT_QUANTITY CM_IDENT 10 0 4096 AXIS_PTS_REF AX_tq_row /end AXIS_DESCR
/end CHARACTERISTIC
/begin CHARACTERISTIC TQLIM_1b1bd4 "input-torque limit Nm @0x1b1bd4 (10x8 grid)" MAP 0x1b1c00 RL_MAP_U16 0 CM_NM 0 4950
 /begin AXIS_DESCR COM_AXIS NO_INPUT_QUANTITY CM_NM 8 0 600 AXIS_PTS_REF AX_tq_col /end AXIS_DESCR
 /begin AXIS_DESCR COM_AXIS NO_INPUT_QUANTITY CM_IDENT 10 0 4096 AXIS_PTS_REF AX_tq_row /end AXIS_DESCR
/end CHARACTERISTIC
/begin CHARACTERISTIC TQLIM_1b1ca0 "input-torque limit Nm @0x1b1ca0 (10x8 grid)" MAP 0x1b1ccc RL_MAP_U16 0 CM_NM 0 4950
 /begin AXIS_DESCR COM_AXIS NO_INPUT_QUANTITY CM_NM 8 0 600 AXIS_PTS_REF AX_tq_col /end AXIS_DESCR
 /begin AXIS_DESCR COM_AXIS NO_INPUT_QUANTITY CM_IDENT 10 0 4096 AXIS_PTS_REF AX_tq_row /end AXIS_DESCR
/end CHARACTERISTIC
/begin CHARACTERISTIC TQLIM_1b1e04 "input-torque limit Nm @0x1b1e04 (10x8 grid)" MAP 0x1b1e30 RL_MAP_U16 0 CM_NM 0 4950
 /begin AXIS_DESCR COM_AXIS NO_INPUT_QUANTITY CM_NM 8 0 600 AXIS_PTS_REF AX_tq_col /end AXIS_DESCR
 /begin AXIS_DESCR COM_AXIS NO_INPUT_QUANTITY CM_IDENT 10 0 4096 AXIS_PTS_REF AX_tq_row /end AXIS_DESCR
/end CHARACTERISTIC
/begin CHARACTERISTIC TQLIM_1b1ed0 "input-torque limit Nm @0x1b1ed0 (10x8 grid)" MAP 0x1b1efc RL_MAP_U16 0 CM_NM 0 4950
 /begin AXIS_DESCR COM_AXIS NO_INPUT_QUANTITY CM_NM 8 0 600 AXIS_PTS_REF AX_tq_col /end AXIS_DESCR
 /begin AXIS_DESCR COM_AXIS NO_INPUT_QUANTITY CM_IDENT 10 0 4096 AXIS_PTS_REF AX_tq_row /end AXIS_DESCR
/end CHARACTERISTIC
/begin CHARACTERISTIC TQLIM_1b1f9c "input-torque limit Nm @0x1b1f9c (10x8 grid)" MAP 0x1b1fc8 RL_MAP_U16 0 CM_NM 0 4950
 /begin AXIS_DESCR COM_AXIS NO_INPUT_QUANTITY CM_NM 8 0 600 AXIS_PTS_REF AX_tq_col /end AXIS_DESCR
 /begin AXIS_DESCR COM_AXIS NO_INPUT_QUANTITY CM_IDENT 10 0 4096 AXIS_PTS_REF AX_tq_row /end AXIS_DESCR
/end CHARACTERISTIC
/begin CHARACTERISTIC TQLIM_1b2114 "input-torque limit Nm @0x1b2114 (10x8 grid)" MAP 0x1b2140 RL_MAP_U16 0 CM_NM 0 4950
 /begin AXIS_DESCR COM_AXIS NO_INPUT_QUANTITY CM_NM 8 0 600 AXIS_PTS_REF AX_tq_col /end AXIS_DESCR
 /begin AXIS_DESCR COM_AXIS NO_INPUT_QUANTITY CM_IDENT 10 0 4096 AXIS_PTS_REF AX_tq_row /end AXIS_DESCR
/end CHARACTERISTIC
/begin CHARACTERISTIC TQLIM_1b21e0 "input-torque limit Nm @0x1b21e0 (10x8 grid)" MAP 0x1b220c RL_MAP_U16 0 CM_NM 0 4950
 /begin AXIS_DESCR COM_AXIS NO_INPUT_QUANTITY CM_NM 8 0 600 AXIS_PTS_REF AX_tq_col /end AXIS_DESCR
 /begin AXIS_DESCR COM_AXIS NO_INPUT_QUANTITY CM_IDENT 10 0 4096 AXIS_PTS_REF AX_tq_row /end AXIS_DESCR
/end CHARACTERISTIC
/begin CHARACTERISTIC TQLIM_1b22ac "input-torque limit Nm @0x1b22ac (10x8 grid)" MAP 0x1b22d8 RL_MAP_U16 0 CM_NM 0 4950
 /begin AXIS_DESCR COM_AXIS NO_INPUT_QUANTITY CM_NM 8 0 600 AXIS_PTS_REF AX_tq_col /end AXIS_DESCR
 /begin AXIS_DESCR COM_AXIS NO_INPUT_QUANTITY CM_IDENT 10 0 4096 AXIS_PTS_REF AX_tq_row /end AXIS_DESCR
/end CHARACTERISTIC
/begin CHARACTERISTIC TQLIM_1b2378 "input-torque limit Nm @0x1b2378 (10x8 grid)" MAP 0x1b23a4 RL_MAP_U16 0 CM_NM 0 4950
 /begin AXIS_DESCR COM_AXIS NO_INPUT_QUANTITY CM_NM 8 0 600 AXIS_PTS_REF AX_tq_col /end AXIS_DESCR
 /begin AXIS_DESCR COM_AXIS NO_INPUT_QUANTITY CM_IDENT 10 0 4096 AXIS_PTS_REF AX_tq_row /end AXIS_DESCR
/end CHARACTERISTIC
/begin CHARACTERISTIC TQLIM_1b2444 "input-torque limit Nm @0x1b2444 (10x8 grid)" MAP 0x1b2470 RL_MAP_U16 0 CM_NM 0 4950
 /begin AXIS_DESCR COM_AXIS NO_INPUT_QUANTITY CM_NM 8 0 600 AXIS_PTS_REF AX_tq_col /end AXIS_DESCR
 /begin AXIS_DESCR COM_AXIS NO_INPUT_QUANTITY CM_IDENT 10 0 4096 AXIS_PTS_REF AX_tq_row /end AXIS_DESCR
/end CHARACTERISTIC
/begin CHARACTERISTIC TQLIM_1b2510 "input-torque limit Nm @0x1b2510 (10x8 grid)" MAP 0x1b253c RL_MAP_U16 0 CM_NM 0 4950
 /begin AXIS_DESCR COM_AXIS NO_INPUT_QUANTITY CM_NM 8 0 600 AXIS_PTS_REF AX_tq_col /end AXIS_DESCR
 /begin AXIS_DESCR COM_AXIS NO_INPUT_QUANTITY CM_IDENT 10 0 4096 AXIS_PTS_REF AX_tq_row /end AXIS_DESCR
/end CHARACTERISTIC
/begin CHARACTERISTIC TQLIM_1b2688 "input-torque limit Nm @0x1b2688 (10x8 grid)" MAP 0x1b26b4 RL_MAP_U16 0 CM_NM 0 4950
 /begin AXIS_DESCR COM_AXIS NO_INPUT_QUANTITY CM_NM 8 0 600 AXIS_PTS_REF AX_tq_col /end AXIS_DESCR
 /begin AXIS_DESCR COM_AXIS NO_INPUT_QUANTITY CM_IDENT 10 0 4096 AXIS_PTS_REF AX_tq_row /end AXIS_DESCR
/end CHARACTERISTIC
/begin CHARACTERISTIC TQLIM_1b2754 "input-torque limit Nm @0x1b2754 (10x8 grid)" MAP 0x1b2780 RL_MAP_U16 0 CM_NM 0 4950
 /begin AXIS_DESCR COM_AXIS NO_INPUT_QUANTITY CM_NM 8 0 600 AXIS_PTS_REF AX_tq_col /end AXIS_DESCR
 /begin AXIS_DESCR COM_AXIS NO_INPUT_QUANTITY CM_IDENT 10 0 4096 AXIS_PTS_REF AX_tq_row /end AXIS_DESCR
/end CHARACTERISTIC
/begin CHARACTERISTIC TQLIM_1b2820 "input-torque limit Nm @0x1b2820 (10x8 grid)" MAP 0x1b284c RL_MAP_U16 0 CM_NM 0 4950
 /begin AXIS_DESCR COM_AXIS NO_INPUT_QUANTITY CM_NM 8 0 600 AXIS_PTS_REF AX_tq_col /end AXIS_DESCR
 /begin AXIS_DESCR COM_AXIS NO_INPUT_QUANTITY CM_IDENT 10 0 4096 AXIS_PTS_REF AX_tq_row /end AXIS_DESCR
/end CHARACTERISTIC
/begin CHARACTERISTIC TQLIM_1b28ec "input-torque limit Nm @0x1b28ec (10x8 grid)" MAP 0x1b2918 RL_MAP_U16 0 CM_NM 0 4950
 /begin AXIS_DESCR COM_AXIS NO_INPUT_QUANTITY CM_NM 8 0 600 AXIS_PTS_REF AX_tq_col /end AXIS_DESCR
 /begin AXIS_DESCR COM_AXIS NO_INPUT_QUANTITY CM_IDENT 10 0 4096 AXIS_PTS_REF AX_tq_row /end AXIS_DESCR
/end CHARACTERISTIC
/begin CHARACTERISTIC TQLIM_1b29b8 "input-torque limit Nm @0x1b29b8 (10x8 grid)" MAP 0x1b29e4 RL_MAP_U16 0 CM_NM 0 4950
 /begin AXIS_DESCR COM_AXIS NO_INPUT_QUANTITY CM_NM 8 0 600 AXIS_PTS_REF AX_tq_col /end AXIS_DESCR
 /begin AXIS_DESCR COM_AXIS NO_INPUT_QUANTITY CM_IDENT 10 0 4096 AXIS_PTS_REF AX_tq_row /end AXIS_DESCR
/end CHARACTERISTIC
/begin CHARACTERISTIC TQLIM_1b2a84 "input-torque limit Nm @0x1b2a84 (10x8 grid)" MAP 0x1b2ab0 RL_MAP_U16 0 CM_NM 0 4950
 /begin AXIS_DESCR COM_AXIS NO_INPUT_QUANTITY CM_NM 8 0 600 AXIS_PTS_REF AX_tq_col /end AXIS_DESCR
 /begin AXIS_DESCR COM_AXIS NO_INPUT_QUANTITY CM_IDENT 10 0 4096 AXIS_PTS_REF AX_tq_row /end AXIS_DESCR
/end CHARACTERISTIC
/begin CHARACTERISTIC TQLIM_1b2bfc "input-torque limit Nm @0x1b2bfc (10x8 grid)" MAP 0x1b2c28 RL_MAP_U16 0 CM_NM 0 4950
 /begin AXIS_DESCR COM_AXIS NO_INPUT_QUANTITY CM_NM 8 0 600 AXIS_PTS_REF AX_tq_col /end AXIS_DESCR
 /begin AXIS_DESCR COM_AXIS NO_INPUT_QUANTITY CM_IDENT 10 0 4096 AXIS_PTS_REF AX_tq_row /end AXIS_DESCR
/end CHARACTERISTIC
/begin CHARACTERISTIC TQLIM_1b2cc8 "input-torque limit Nm @0x1b2cc8 (10x8 grid)" MAP 0x1b2cf4 RL_MAP_U16 0 CM_NM 0 4950
 /begin AXIS_DESCR COM_AXIS NO_INPUT_QUANTITY CM_NM 8 0 600 AXIS_PTS_REF AX_tq_col /end AXIS_DESCR
 /begin AXIS_DESCR COM_AXIS NO_INPUT_QUANTITY CM_IDENT 10 0 4096 AXIS_PTS_REF AX_tq_row /end AXIS_DESCR
/end CHARACTERISTIC
/begin CHARACTERISTIC TQLIM_1b2d94 "input-torque limit Nm @0x1b2d94 (10x8 grid)" MAP 0x1b2dc0 RL_MAP_U16 0 CM_NM 0 4950
 /begin AXIS_DESCR COM_AXIS NO_INPUT_QUANTITY CM_NM 8 0 600 AXIS_PTS_REF AX_tq_col /end AXIS_DESCR
 /begin AXIS_DESCR COM_AXIS NO_INPUT_QUANTITY CM_IDENT 10 0 4096 AXIS_PTS_REF AX_tq_row /end AXIS_DESCR
/end CHARACTERISTIC
/begin CHARACTERISTIC TQLIM_1b2e60 "input-torque limit Nm @0x1b2e60 (10x8 grid)" MAP 0x1b2e8c RL_MAP_U16 0 CM_NM 0 4950
 /begin AXIS_DESCR COM_AXIS NO_INPUT_QUANTITY CM_NM 8 0 600 AXIS_PTS_REF AX_tq_col /end AXIS_DESCR
 /begin AXIS_DESCR COM_AXIS NO_INPUT_QUANTITY CM_IDENT 10 0 4096 AXIS_PTS_REF AX_tq_row /end AXIS_DESCR
/end CHARACTERISTIC
/begin CHARACTERISTIC TQLIM_1b2f2c "input-torque limit Nm @0x1b2f2c (10x8 grid)" MAP 0x1b2f58 RL_MAP_U16 0 CM_NM 0 4950
 /begin AXIS_DESCR COM_AXIS NO_INPUT_QUANTITY CM_NM 8 0 600 AXIS_PTS_REF AX_tq_col /end AXIS_DESCR
 /begin AXIS_DESCR COM_AXIS NO_INPUT_QUANTITY CM_IDENT 10 0 4096 AXIS_PTS_REF AX_tq_row /end AXIS_DESCR
/end CHARACTERISTIC
/* ==== TUNABLE: shift-curve output columns (shift-RPM thresholds) ==== */
/begin CHARACTERISTIC SHIFT_1d3330 "shift curve out-col @0x1d3330 (max 7110)" CURVE 0x1d333e RL_CURVE_U16 0 CM_RPM 0 8000
 /begin AXIS_DESCR COM_AXIS NO_INPUT_QUANTITY CM_RPM 7 0 8000 AXIS_PTS_REF AX_shift_rpm /end AXIS_DESCR
/end CHARACTERISTIC
/begin CHARACTERISTIC SHIFT_1d34bc "shift curve out-col @0x1d34bc (max 7110)" CURVE 0x1d34ca RL_CURVE_U16 0 CM_RPM 0 8000
 /begin AXIS_DESCR COM_AXIS NO_INPUT_QUANTITY CM_RPM 7 0 8000 AXIS_PTS_REF AX_shift_rpm /end AXIS_DESCR
/end CHARACTERISTIC
/begin CHARACTERISTIC SHIFT_1d3648 "shift curve out-col @0x1d3648 (max 7250)" CURVE 0x1d3656 RL_CURVE_U16 0 CM_RPM 0 8000
 /begin AXIS_DESCR COM_AXIS NO_INPUT_QUANTITY CM_RPM 7 0 8000 AXIS_PTS_REF AX_shift_rpm /end AXIS_DESCR
/end CHARACTERISTIC
/begin CHARACTERISTIC SHIFT_1d37d4 "shift curve out-col @0x1d37d4 (max 7250)" CURVE 0x1d37e2 RL_CURVE_U16 0 CM_RPM 0 8000
 /begin AXIS_DESCR COM_AXIS NO_INPUT_QUANTITY CM_RPM 7 0 8000 AXIS_PTS_REF AX_shift_rpm /end AXIS_DESCR
/end CHARACTERISTIC
/begin CHARACTERISTIC SHIFT_1d3c78 "shift curve out-col @0x1d3c78 (max 7250)" CURVE 0x1d3c86 RL_CURVE_U16 0 CM_RPM 0 8000
 /begin AXIS_DESCR COM_AXIS NO_INPUT_QUANTITY CM_RPM 7 0 8000 AXIS_PTS_REF AX_shift_rpm /end AXIS_DESCR
/end CHARACTERISTIC
/begin CHARACTERISTIC SHIFT_1d3e04 "shift curve out-col @0x1d3e04 (max 7250)" CURVE 0x1d3e12 RL_CURVE_U16 0 CM_RPM 0 8000
 /begin AXIS_DESCR COM_AXIS NO_INPUT_QUANTITY CM_RPM 7 0 8000 AXIS_PTS_REF AX_shift_rpm /end AXIS_DESCR
/end CHARACTERISTIC
/begin CHARACTERISTIC SHIFT_1d3f90 "shift curve out-col @0x1d3f90 (max 7250)" CURVE 0x1d3f9e RL_CURVE_U16 0 CM_RPM 0 8000
 /begin AXIS_DESCR COM_AXIS NO_INPUT_QUANTITY CM_RPM 7 0 8000 AXIS_PTS_REF AX_shift_rpm /end AXIS_DESCR
/end CHARACTERISTIC
/begin CHARACTERISTIC SHIFT_1d411c "shift curve out-col @0x1d411c (max 7250)" CURVE 0x1d412a RL_CURVE_U16 0 CM_RPM 0 8000
 /begin AXIS_DESCR COM_AXIS NO_INPUT_QUANTITY CM_RPM 7 0 8000 AXIS_PTS_REF AX_shift_rpm /end AXIS_DESCR
/end CHARACTERISTIC
/begin CHARACTERISTIC SHIFT_1d428c "shift curve out-col @0x1d428c (max 6000)" CURVE 0x1d429a RL_CURVE_U16 0 CM_RPM 0 8000
 /begin AXIS_DESCR COM_AXIS NO_INPUT_QUANTITY CM_RPM 7 0 8000 AXIS_PTS_REF AX_shift_rpm /end AXIS_DESCR
/end CHARACTERISTIC
/begin CHARACTERISTIC SHIFT_1d42a8 "shift curve out-col @0x1d42a8 (max 7250)" CURVE 0x1d42b6 RL_CURVE_U16 0 CM_RPM 0 8000
 /begin AXIS_DESCR COM_AXIS NO_INPUT_QUANTITY CM_RPM 7 0 8000 AXIS_PTS_REF AX_shift_rpm /end AXIS_DESCR
/end CHARACTERISTIC
/begin CHARACTERISTIC SHIFT_1d4418 "shift curve out-col @0x1d4418 (max 6000)" CURVE 0x1d4426 RL_CURVE_U16 0 CM_RPM 0 8000
 /begin AXIS_DESCR COM_AXIS NO_INPUT_QUANTITY CM_RPM 7 0 8000 AXIS_PTS_REF AX_shift_rpm /end AXIS_DESCR
/end CHARACTERISTIC
/begin CHARACTERISTIC SHIFT_1d4434 "shift curve out-col @0x1d4434 (max 7250)" CURVE 0x1d4442 RL_CURVE_U16 0 CM_RPM 0 8000
 /begin AXIS_DESCR COM_AXIS NO_INPUT_QUANTITY CM_RPM 7 0 8000 AXIS_PTS_REF AX_shift_rpm /end AXIS_DESCR
/end CHARACTERISTIC
/begin CHARACTERISTIC SHIFT_1d45a4 "shift curve out-col @0x1d45a4 (max 6000)" CURVE 0x1d45b2 RL_CURVE_U16 0 CM_RPM 0 8000
 /begin AXIS_DESCR COM_AXIS NO_INPUT_QUANTITY CM_RPM 7 0 8000 AXIS_PTS_REF AX_shift_rpm /end AXIS_DESCR
/end CHARACTERISTIC
/begin CHARACTERISTIC SHIFT_1d45c0 "shift curve out-col @0x1d45c0 (max 7250)" CURVE 0x1d45ce RL_CURVE_U16 0 CM_RPM 0 8000
 /begin AXIS_DESCR COM_AXIS NO_INPUT_QUANTITY CM_RPM 7 0 8000 AXIS_PTS_REF AX_shift_rpm /end AXIS_DESCR
/end CHARACTERISTIC
/begin CHARACTERISTIC SHIFT_1d4730 "shift curve out-col @0x1d4730 (max 6000)" CURVE 0x1d473e RL_CURVE_U16 0 CM_RPM 0 8000
 /begin AXIS_DESCR COM_AXIS NO_INPUT_QUANTITY CM_RPM 7 0 8000 AXIS_PTS_REF AX_shift_rpm /end AXIS_DESCR
/end CHARACTERISTIC
/begin CHARACTERISTIC SHIFT_1d474c "shift curve out-col @0x1d474c (max 7250)" CURVE 0x1d475a RL_CURVE_U16 0 CM_RPM 0 8000
 /begin AXIS_DESCR COM_AXIS NO_INPUT_QUANTITY CM_RPM 7 0 8000 AXIS_PTS_REF AX_shift_rpm /end AXIS_DESCR
/end CHARACTERISTIC
/begin CHARACTERISTIC SHIFT_1d48bc "shift curve out-col @0x1d48bc (max 7250)" CURVE 0x1d48ca RL_CURVE_U16 0 CM_RPM 0 8000
 /begin AXIS_DESCR COM_AXIS NO_INPUT_QUANTITY CM_RPM 7 0 8000 AXIS_PTS_REF AX_shift_rpm /end AXIS_DESCR
/end CHARACTERISTIC
/begin CHARACTERISTIC SHIFT_1d48d8 "shift curve out-col @0x1d48d8 (max 7250)" CURVE 0x1d48e6 RL_CURVE_U16 0 CM_RPM 0 8000
 /begin AXIS_DESCR COM_AXIS NO_INPUT_QUANTITY CM_RPM 7 0 8000 AXIS_PTS_REF AX_shift_rpm /end AXIS_DESCR
/end CHARACTERISTIC
/begin CHARACTERISTIC SHIFT_1d4a48 "shift curve out-col @0x1d4a48 (max 7250)" CURVE 0x1d4a56 RL_CURVE_U16 0 CM_RPM 0 8000
 /begin AXIS_DESCR COM_AXIS NO_INPUT_QUANTITY CM_RPM 7 0 8000 AXIS_PTS_REF AX_shift_rpm /end AXIS_DESCR
/end CHARACTERISTIC
/begin CHARACTERISTIC SHIFT_1d4a64 "shift curve out-col @0x1d4a64 (max 7250)" CURVE 0x1d4a72 RL_CURVE_U16 0 CM_RPM 0 8000
 /begin AXIS_DESCR COM_AXIS NO_INPUT_QUANTITY CM_RPM 7 0 8000 AXIS_PTS_REF AX_shift_rpm /end AXIS_DESCR
/end CHARACTERISTIC
/begin CHARACTERISTIC SHIFT_1d4bf0 "shift curve out-col @0x1d4bf0 (max 7250)" CURVE 0x1d4bfe RL_CURVE_U16 0 CM_RPM 0 8000
 /begin AXIS_DESCR COM_AXIS NO_INPUT_QUANTITY CM_RPM 7 0 8000 AXIS_PTS_REF AX_shift_rpm /end AXIS_DESCR
/end CHARACTERISTIC
/begin CHARACTERISTIC SHIFT_1d4d7c "shift curve out-col @0x1d4d7c (max 7250)" CURVE 0x1d4d8a RL_CURVE_U16 0 CM_RPM 0 8000
 /begin AXIS_DESCR COM_AXIS NO_INPUT_QUANTITY CM_RPM 7 0 8000 AXIS_PTS_REF AX_shift_rpm /end AXIS_DESCR
/end CHARACTERISTIC
/begin CHARACTERISTIC SHIFT_1d4f08 "shift curve out-col @0x1d4f08 (max 7250)" CURVE 0x1d4f16 RL_CURVE_U16 0 CM_RPM 0 8000
 /begin AXIS_DESCR COM_AXIS NO_INPUT_QUANTITY CM_RPM 7 0 8000 AXIS_PTS_REF AX_shift_rpm /end AXIS_DESCR
/end CHARACTERISTIC
/begin CHARACTERISTIC SHIFT_1d5094 "shift curve out-col @0x1d5094 (max 7250)" CURVE 0x1d50a2 RL_CURVE_U16 0 CM_RPM 0 8000
 /begin AXIS_DESCR COM_AXIS NO_INPUT_QUANTITY CM_RPM 7 0 8000 AXIS_PTS_REF AX_shift_rpm /end AXIS_DESCR
/end CHARACTERISTIC
/begin CHARACTERISTIC SHIFT_1d5220 "shift curve out-col @0x1d5220 (max 7250)" CURVE 0x1d522e RL_CURVE_U16 0 CM_RPM 0 8000
 /begin AXIS_DESCR COM_AXIS NO_INPUT_QUANTITY CM_RPM 7 0 8000 AXIS_PTS_REF AX_shift_rpm /end AXIS_DESCR
/end CHARACTERISTIC
/begin CHARACTERISTIC SHIFT_1d53ac "shift curve out-col @0x1d53ac (max 7250)" CURVE 0x1d53ba RL_CURVE_U16 0 CM_RPM 0 8000
 /begin AXIS_DESCR COM_AXIS NO_INPUT_QUANTITY CM_RPM 7 0 8000 AXIS_PTS_REF AX_shift_rpm /end AXIS_DESCR
/end CHARACTERISTIC
/begin CHARACTERISTIC SHIFT_1d551c "shift curve out-col @0x1d551c (max 6000)" CURVE 0x1d552a RL_CURVE_U16 0 CM_RPM 0 8000
 /begin AXIS_DESCR COM_AXIS NO_INPUT_QUANTITY CM_RPM 7 0 8000 AXIS_PTS_REF AX_shift_rpm /end AXIS_DESCR
/end CHARACTERISTIC
/begin CHARACTERISTIC SHIFT_1d5538 "shift curve out-col @0x1d5538 (max 7250)" CURVE 0x1d5546 RL_CURVE_U16 0 CM_RPM 0 8000
 /begin AXIS_DESCR COM_AXIS NO_INPUT_QUANTITY CM_RPM 7 0 8000 AXIS_PTS_REF AX_shift_rpm /end AXIS_DESCR
/end CHARACTERISTIC
/begin CHARACTERISTIC SHIFT_1d56a8 "shift curve out-col @0x1d56a8 (max 6000)" CURVE 0x1d56b6 RL_CURVE_U16 0 CM_RPM 0 8000
 /begin AXIS_DESCR COM_AXIS NO_INPUT_QUANTITY CM_RPM 7 0 8000 AXIS_PTS_REF AX_shift_rpm /end AXIS_DESCR
/end CHARACTERISTIC
/begin CHARACTERISTIC SHIFT_1d56c4 "shift curve out-col @0x1d56c4 (max 7250)" CURVE 0x1d56d2 RL_CURVE_U16 0 CM_RPM 0 8000
 /begin AXIS_DESCR COM_AXIS NO_INPUT_QUANTITY CM_RPM 7 0 8000 AXIS_PTS_REF AX_shift_rpm /end AXIS_DESCR
/end CHARACTERISTIC
/begin CHARACTERISTIC SHIFT_1d5834 "shift curve out-col @0x1d5834 (max 7250)" CURVE 0x1d5842 RL_CURVE_U16 0 CM_RPM 0 8000
 /begin AXIS_DESCR COM_AXIS NO_INPUT_QUANTITY CM_RPM 7 0 8000 AXIS_PTS_REF AX_shift_rpm /end AXIS_DESCR
/end CHARACTERISTIC
/begin CHARACTERISTIC SHIFT_1d5850 "shift curve out-col @0x1d5850 (max 7250)" CURVE 0x1d585e RL_CURVE_U16 0 CM_RPM 0 8000
 /begin AXIS_DESCR COM_AXIS NO_INPUT_QUANTITY CM_RPM 7 0 8000 AXIS_PTS_REF AX_shift_rpm /end AXIS_DESCR
/end CHARACTERISTIC
/begin CHARACTERISTIC SHIFT_1d59c0 "shift curve out-col @0x1d59c0 (max 7250)" CURVE 0x1d59ce RL_CURVE_U16 0 CM_RPM 0 8000
 /begin AXIS_DESCR COM_AXIS NO_INPUT_QUANTITY CM_RPM 7 0 8000 AXIS_PTS_REF AX_shift_rpm /end AXIS_DESCR
/end CHARACTERISTIC
/begin CHARACTERISTIC SHIFT_1d59dc "shift curve out-col @0x1d59dc (max 7250)" CURVE 0x1d59ea RL_CURVE_U16 0 CM_RPM 0 8000
 /begin AXIS_DESCR COM_AXIS NO_INPUT_QUANTITY CM_RPM 7 0 8000 AXIS_PTS_REF AX_shift_rpm /end AXIS_DESCR
/end CHARACTERISTIC
/begin CHARACTERISTIC SHIFT_1d5b68 "shift curve out-col @0x1d5b68 (max 7250)" CURVE 0x1d5b76 RL_CURVE_U16 0 CM_RPM 0 8000
 /begin AXIS_DESCR COM_AXIS NO_INPUT_QUANTITY CM_RPM 7 0 8000 AXIS_PTS_REF AX_shift_rpm /end AXIS_DESCR
/end CHARACTERISTIC
/begin CHARACTERISTIC SHIFT_1d5cf4 "shift curve out-col @0x1d5cf4 (max 7250)" CURVE 0x1d5d02 RL_CURVE_U16 0 CM_RPM 0 8000
 /begin AXIS_DESCR COM_AXIS NO_INPUT_QUANTITY CM_RPM 7 0 8000 AXIS_PTS_REF AX_shift_rpm /end AXIS_DESCR
/end CHARACTERISTIC
/begin CHARACTERISTIC SHIFT_1d5e48 "shift curve out-col @0x1d5e48 (max 7250)" CURVE 0x1d5e56 RL_CURVE_U16 0 CM_RPM 0 8000
 /begin AXIS_DESCR COM_AXIS NO_INPUT_QUANTITY CM_RPM 7 0 8000 AXIS_PTS_REF AX_shift_rpm /end AXIS_DESCR
/end CHARACTERISTIC
/begin CHARACTERISTIC SHIFT_1d5e64 "shift curve out-col @0x1d5e64 (max 7250)" CURVE 0x1d5e72 RL_CURVE_U16 0 CM_RPM 0 8000
 /begin AXIS_DESCR COM_AXIS NO_INPUT_QUANTITY CM_RPM 7 0 8000 AXIS_PTS_REF AX_shift_rpm /end AXIS_DESCR
/end CHARACTERISTIC
/begin CHARACTERISTIC SHIFT_1d5e80 "shift curve out-col @0x1d5e80 (max 7250)" CURVE 0x1d5e8e RL_CURVE_U16 0 CM_RPM 0 8000
 /begin AXIS_DESCR COM_AXIS NO_INPUT_QUANTITY CM_RPM 7 0 8000 AXIS_PTS_REF AX_shift_rpm /end AXIS_DESCR
/end CHARACTERISTIC
/begin CHARACTERISTIC SHIFT_1d5fd4 "shift curve out-col @0x1d5fd4 (max 7250)" CURVE 0x1d5fe2 RL_CURVE_U16 0 CM_RPM 0 8000
 /begin AXIS_DESCR COM_AXIS NO_INPUT_QUANTITY CM_RPM 7 0 8000 AXIS_PTS_REF AX_shift_rpm /end AXIS_DESCR
/end CHARACTERISTIC
/begin CHARACTERISTIC SHIFT_1d5ff0 "shift curve out-col @0x1d5ff0 (max 7250)" CURVE 0x1d5ffe RL_CURVE_U16 0 CM_RPM 0 8000
 /begin AXIS_DESCR COM_AXIS NO_INPUT_QUANTITY CM_RPM 7 0 8000 AXIS_PTS_REF AX_shift_rpm /end AXIS_DESCR
/end CHARACTERISTIC
/begin CHARACTERISTIC SHIFT_1d600c "shift curve out-col @0x1d600c (max 7250)" CURVE 0x1d601a RL_CURVE_U16 0 CM_RPM 0 8000
 /begin AXIS_DESCR COM_AXIS NO_INPUT_QUANTITY CM_RPM 7 0 8000 AXIS_PTS_REF AX_shift_rpm /end AXIS_DESCR
/end CHARACTERISTIC
/begin CHARACTERISTIC SHIFT_1d6160 "shift curve out-col @0x1d6160 (max 7250)" CURVE 0x1d616e RL_CURVE_U16 0 CM_RPM 0 8000
 /begin AXIS_DESCR COM_AXIS NO_INPUT_QUANTITY CM_RPM 7 0 8000 AXIS_PTS_REF AX_shift_rpm /end AXIS_DESCR
/end CHARACTERISTIC
/begin CHARACTERISTIC SHIFT_1d617c "shift curve out-col @0x1d617c (max 7250)" CURVE 0x1d618a RL_CURVE_U16 0 CM_RPM 0 8000
 /begin AXIS_DESCR COM_AXIS NO_INPUT_QUANTITY CM_RPM 7 0 8000 AXIS_PTS_REF AX_shift_rpm /end AXIS_DESCR
/end CHARACTERISTIC
/begin CHARACTERISTIC SHIFT_1d6198 "shift curve out-col @0x1d6198 (max 7250)" CURVE 0x1d61a6 RL_CURVE_U16 0 CM_RPM 0 8000
 /begin AXIS_DESCR COM_AXIS NO_INPUT_QUANTITY CM_RPM 7 0 8000 AXIS_PTS_REF AX_shift_rpm /end AXIS_DESCR
/end CHARACTERISTIC
/begin CHARACTERISTIC SHIFT_1d62ec "shift curve out-col @0x1d62ec (max 7250)" CURVE 0x1d62fa RL_CURVE_U16 0 CM_RPM 0 8000
 /begin AXIS_DESCR COM_AXIS NO_INPUT_QUANTITY CM_RPM 7 0 8000 AXIS_PTS_REF AX_shift_rpm /end AXIS_DESCR
/end CHARACTERISTIC
/begin CHARACTERISTIC SHIFT_1d6308 "shift curve out-col @0x1d6308 (max 7250)" CURVE 0x1d6316 RL_CURVE_U16 0 CM_RPM 0 8000
 /begin AXIS_DESCR COM_AXIS NO_INPUT_QUANTITY CM_RPM 7 0 8000 AXIS_PTS_REF AX_shift_rpm /end AXIS_DESCR
/end CHARACTERISTIC
/begin CHARACTERISTIC SHIFT_1d6324 "shift curve out-col @0x1d6324 (max 7250)" CURVE 0x1d6332 RL_CURVE_U16 0 CM_RPM 0 8000
 /begin AXIS_DESCR COM_AXIS NO_INPUT_QUANTITY CM_RPM 7 0 8000 AXIS_PTS_REF AX_shift_rpm /end AXIS_DESCR
/end CHARACTERISTIC
/begin CHARACTERISTIC SHIFT_1d6478 "shift curve out-col @0x1d6478 (max 7252)" CURVE 0x1d6486 RL_CURVE_U16 0 CM_RPM 0 8000
 /begin AXIS_DESCR COM_AXIS NO_INPUT_QUANTITY CM_RPM 7 0 8000 AXIS_PTS_REF AX_shift_rpm /end AXIS_DESCR
/end CHARACTERISTIC
/begin CHARACTERISTIC SHIFT_1d6494 "shift curve out-col @0x1d6494 (max 7250)" CURVE 0x1d64a2 RL_CURVE_U16 0 CM_RPM 0 8000
 /begin AXIS_DESCR COM_AXIS NO_INPUT_QUANTITY CM_RPM 7 0 8000 AXIS_PTS_REF AX_shift_rpm /end AXIS_DESCR
/end CHARACTERISTIC
/begin CHARACTERISTIC SHIFT_1d64b0 "shift curve out-col @0x1d64b0 (max 7250)" CURVE 0x1d64be RL_CURVE_U16 0 CM_RPM 0 8000
 /begin AXIS_DESCR COM_AXIS NO_INPUT_QUANTITY CM_RPM 7 0 8000 AXIS_PTS_REF AX_shift_rpm /end AXIS_DESCR
/end CHARACTERISTIC
/begin CHARACTERISTIC SHIFT_1d6604 "shift curve out-col @0x1d6604 (max 7252)" CURVE 0x1d6612 RL_CURVE_U16 0 CM_RPM 0 8000
 /begin AXIS_DESCR COM_AXIS NO_INPUT_QUANTITY CM_RPM 7 0 8000 AXIS_PTS_REF AX_shift_rpm /end AXIS_DESCR
/end CHARACTERISTIC
/begin CHARACTERISTIC SHIFT_1d6620 "shift curve out-col @0x1d6620 (max 7250)" CURVE 0x1d662e RL_CURVE_U16 0 CM_RPM 0 8000
 /begin AXIS_DESCR COM_AXIS NO_INPUT_QUANTITY CM_RPM 7 0 8000 AXIS_PTS_REF AX_shift_rpm /end AXIS_DESCR
/end CHARACTERISTIC
/begin CHARACTERISTIC SHIFT_1d663c "shift curve out-col @0x1d663c (max 7250)" CURVE 0x1d664a RL_CURVE_U16 0 CM_RPM 0 8000
 /begin AXIS_DESCR COM_AXIS NO_INPUT_QUANTITY CM_RPM 7 0 8000 AXIS_PTS_REF AX_shift_rpm /end AXIS_DESCR
/end CHARACTERISTIC
/begin CHARACTERISTIC SHIFT_1d6790 "shift curve out-col @0x1d6790 (max 7250)" CURVE 0x1d679e RL_CURVE_U16 0 CM_RPM 0 8000
 /begin AXIS_DESCR COM_AXIS NO_INPUT_QUANTITY CM_RPM 7 0 8000 AXIS_PTS_REF AX_shift_rpm /end AXIS_DESCR
/end CHARACTERISTIC
/begin CHARACTERISTIC SHIFT_1d67ac "shift curve out-col @0x1d67ac (max 7250)" CURVE 0x1d67ba RL_CURVE_U16 0 CM_RPM 0 8000
 /begin AXIS_DESCR COM_AXIS NO_INPUT_QUANTITY CM_RPM 7 0 8000 AXIS_PTS_REF AX_shift_rpm /end AXIS_DESCR
/end CHARACTERISTIC
/begin CHARACTERISTIC SHIFT_1d67c8 "shift curve out-col @0x1d67c8 (max 7250)" CURVE 0x1d67d6 RL_CURVE_U16 0 CM_RPM 0 8000
 /begin AXIS_DESCR COM_AXIS NO_INPUT_QUANTITY CM_RPM 7 0 8000 AXIS_PTS_REF AX_shift_rpm /end AXIS_DESCR
/end CHARACTERISTIC
/begin CHARACTERISTIC SHIFT_1d691c "shift curve out-col @0x1d691c (max 7250)" CURVE 0x1d692a RL_CURVE_U16 0 CM_RPM 0 8000
 /begin AXIS_DESCR COM_AXIS NO_INPUT_QUANTITY CM_RPM 7 0 8000 AXIS_PTS_REF AX_shift_rpm /end AXIS_DESCR
/end CHARACTERISTIC
/begin CHARACTERISTIC SHIFT_1d6938 "shift curve out-col @0x1d6938 (max 7250)" CURVE 0x1d6946 RL_CURVE_U16 0 CM_RPM 0 8000
 /begin AXIS_DESCR COM_AXIS NO_INPUT_QUANTITY CM_RPM 7 0 8000 AXIS_PTS_REF AX_shift_rpm /end AXIS_DESCR
/end CHARACTERISTIC
/begin CHARACTERISTIC SHIFT_1d6954 "shift curve out-col @0x1d6954 (max 7250)" CURVE 0x1d6962 RL_CURVE_U16 0 CM_RPM 0 8000
 /begin AXIS_DESCR COM_AXIS NO_INPUT_QUANTITY CM_RPM 7 0 8000 AXIS_PTS_REF AX_shift_rpm /end AXIS_DESCR
/end CHARACTERISTIC
/begin CHARACTERISTIC SHIFT_1d6aa8 "shift curve out-col @0x1d6aa8 (max 7250)" CURVE 0x1d6ab6 RL_CURVE_U16 0 CM_RPM 0 8000
 /begin AXIS_DESCR COM_AXIS NO_INPUT_QUANTITY CM_RPM 7 0 8000 AXIS_PTS_REF AX_shift_rpm /end AXIS_DESCR
/end CHARACTERISTIC
/begin CHARACTERISTIC SHIFT_1d6ac4 "shift curve out-col @0x1d6ac4 (max 7250)" CURVE 0x1d6ad2 RL_CURVE_U16 0 CM_RPM 0 8000
 /begin AXIS_DESCR COM_AXIS NO_INPUT_QUANTITY CM_RPM 7 0 8000 AXIS_PTS_REF AX_shift_rpm /end AXIS_DESCR
/end CHARACTERISTIC
/begin CHARACTERISTIC SHIFT_1d6ae0 "shift curve out-col @0x1d6ae0 (max 7250)" CURVE 0x1d6aee RL_CURVE_U16 0 CM_RPM 0 8000
 /begin AXIS_DESCR COM_AXIS NO_INPUT_QUANTITY CM_RPM 7 0 8000 AXIS_PTS_REF AX_shift_rpm /end AXIS_DESCR
/end CHARACTERISTIC
/begin CHARACTERISTIC SHIFT_1d6c34 "shift curve out-col @0x1d6c34 (max 7250)" CURVE 0x1d6c42 RL_CURVE_U16 0 CM_RPM 0 8000
 /begin AXIS_DESCR COM_AXIS NO_INPUT_QUANTITY CM_RPM 7 0 8000 AXIS_PTS_REF AX_shift_rpm /end AXIS_DESCR
/end CHARACTERISTIC
/begin CHARACTERISTIC SHIFT_1d6c50 "shift curve out-col @0x1d6c50 (max 7250)" CURVE 0x1d6c5e RL_CURVE_U16 0 CM_RPM 0 8000
 /begin AXIS_DESCR COM_AXIS NO_INPUT_QUANTITY CM_RPM 7 0 8000 AXIS_PTS_REF AX_shift_rpm /end AXIS_DESCR
/end CHARACTERISTIC
/begin CHARACTERISTIC SHIFT_1d6c6c "shift curve out-col @0x1d6c6c (max 7250)" CURVE 0x1d6c7a RL_CURVE_U16 0 CM_RPM 0 8000
 /begin AXIS_DESCR COM_AXIS NO_INPUT_QUANTITY CM_RPM 7 0 8000 AXIS_PTS_REF AX_shift_rpm /end AXIS_DESCR
/end CHARACTERISTIC
/begin CHARACTERISTIC SHIFT_1d6cc4 "shift curve out-col @0x1d6cc4 (max 7250)" CURVE 0x1d6cd2 RL_CURVE_U16 0 CM_RPM 0 8000
 /begin AXIS_DESCR COM_AXIS NO_INPUT_QUANTITY CM_RPM 7 0 8000 AXIS_PTS_REF AX_shift_rpm /end AXIS_DESCR
/end CHARACTERISTIC
/begin CHARACTERISTIC SHIFT_1d6ce0 "shift curve out-col @0x1d6ce0 (max 7250)" CURVE 0x1d6cee RL_CURVE_U16 0 CM_RPM 0 8000
 /begin AXIS_DESCR COM_AXIS NO_INPUT_QUANTITY CM_RPM 7 0 8000 AXIS_PTS_REF AX_shift_rpm /end AXIS_DESCR
/end CHARACTERISTIC
/begin CHARACTERISTIC SHIFT_1d6cfc "shift curve out-col @0x1d6cfc (max 7250)" CURVE 0x1d6d0a RL_CURVE_U16 0 CM_RPM 0 8000
 /begin AXIS_DESCR COM_AXIS NO_INPUT_QUANTITY CM_RPM 7 0 8000 AXIS_PTS_REF AX_shift_rpm /end AXIS_DESCR
/end CHARACTERISTIC
/begin CHARACTERISTIC SHIFT_1d6d18 "shift curve out-col @0x1d6d18 (max 7250)" CURVE 0x1d6d26 RL_CURVE_U16 0 CM_RPM 0 8000
 /begin AXIS_DESCR COM_AXIS NO_INPUT_QUANTITY CM_RPM 7 0 8000 AXIS_PTS_REF AX_shift_rpm /end AXIS_DESCR
/end CHARACTERISTIC
/begin CHARACTERISTIC SHIFT_1d6d34 "shift curve out-col @0x1d6d34 (max 7250)" CURVE 0x1d6d42 RL_CURVE_U16 0 CM_RPM 0 8000
 /begin AXIS_DESCR COM_AXIS NO_INPUT_QUANTITY CM_RPM 7 0 8000 AXIS_PTS_REF AX_shift_rpm /end AXIS_DESCR
/end CHARACTERISTIC
/begin CHARACTERISTIC SHIFT_1d6d50 "shift curve out-col @0x1d6d50 (max 7250)" CURVE 0x1d6d5e RL_CURVE_U16 0 CM_RPM 0 8000
 /begin AXIS_DESCR COM_AXIS NO_INPUT_QUANTITY CM_RPM 7 0 8000 AXIS_PTS_REF AX_shift_rpm /end AXIS_DESCR
/end CHARACTERISTIC
/begin CHARACTERISTIC SHIFT_1d6d6c "shift curve out-col @0x1d6d6c (max 7250)" CURVE 0x1d6d7a RL_CURVE_U16 0 CM_RPM 0 8000
 /begin AXIS_DESCR COM_AXIS NO_INPUT_QUANTITY CM_RPM 7 0 8000 AXIS_PTS_REF AX_shift_rpm /end AXIS_DESCR
/end CHARACTERISTIC
/begin CHARACTERISTIC SHIFT_1d6d88 "shift curve out-col @0x1d6d88 (max 7250)" CURVE 0x1d6d96 RL_CURVE_U16 0 CM_RPM 0 8000
 /begin AXIS_DESCR COM_AXIS NO_INPUT_QUANTITY CM_RPM 7 0 8000 AXIS_PTS_REF AX_shift_rpm /end AXIS_DESCR
/end CHARACTERISTIC
/begin CHARACTERISTIC SHIFT_1d6da4 "shift curve out-col @0x1d6da4 (max 7250)" CURVE 0x1d6db2 RL_CURVE_U16 0 CM_RPM 0 8000
 /begin AXIS_DESCR COM_AXIS NO_INPUT_QUANTITY CM_RPM 7 0 8000 AXIS_PTS_REF AX_shift_rpm /end AXIS_DESCR
/end CHARACTERISTIC
/begin CHARACTERISTIC SHIFT_1d6dc0 "shift curve out-col @0x1d6dc0 (max 7250)" CURVE 0x1d6dce RL_CURVE_U16 0 CM_RPM 0 8000
 /begin AXIS_DESCR COM_AXIS NO_INPUT_QUANTITY CM_RPM 7 0 8000 AXIS_PTS_REF AX_shift_rpm /end AXIS_DESCR
/end CHARACTERISTIC
/begin CHARACTERISTIC SHIFT_1d6ddc "shift curve out-col @0x1d6ddc (max 7250)" CURVE 0x1d6dea RL_CURVE_U16 0 CM_RPM 0 8000
 /begin AXIS_DESCR COM_AXIS NO_INPUT_QUANTITY CM_RPM 7 0 8000 AXIS_PTS_REF AX_shift_rpm /end AXIS_DESCR
/end CHARACTERISTIC
/begin CHARACTERISTIC SHIFT_1d6df8 "shift curve out-col @0x1d6df8 (max 7250)" CURVE 0x1d6e06 RL_CURVE_U16 0 CM_RPM 0 8000
 /begin AXIS_DESCR COM_AXIS NO_INPUT_QUANTITY CM_RPM 7 0 8000 AXIS_PTS_REF AX_shift_rpm /end AXIS_DESCR
/end CHARACTERISTIC
/begin CHARACTERISTIC SHIFT_1d6e50 "shift curve out-col @0x1d6e50 (max 7250)" CURVE 0x1d6e5e RL_CURVE_U16 0 CM_RPM 0 8000
 /begin AXIS_DESCR COM_AXIS NO_INPUT_QUANTITY CM_RPM 7 0 8000 AXIS_PTS_REF AX_shift_rpm /end AXIS_DESCR
/end CHARACTERISTIC
/begin CHARACTERISTIC SHIFT_1d6e6c "shift curve out-col @0x1d6e6c (max 7250)" CURVE 0x1d6e7a RL_CURVE_U16 0 CM_RPM 0 8000
 /begin AXIS_DESCR COM_AXIS NO_INPUT_QUANTITY CM_RPM 7 0 8000 AXIS_PTS_REF AX_shift_rpm /end AXIS_DESCR
/end CHARACTERISTIC
/begin CHARACTERISTIC SHIFT_1d6e88 "shift curve out-col @0x1d6e88 (max 7250)" CURVE 0x1d6e96 RL_CURVE_U16 0 CM_RPM 0 8000
 /begin AXIS_DESCR COM_AXIS NO_INPUT_QUANTITY CM_RPM 7 0 8000 AXIS_PTS_REF AX_shift_rpm /end AXIS_DESCR
/end CHARACTERISTIC
/begin CHARACTERISTIC SHIFT_1d6ea4 "shift curve out-col @0x1d6ea4 (max 7250)" CURVE 0x1d6eb2 RL_CURVE_U16 0 CM_RPM 0 8000
 /begin AXIS_DESCR COM_AXIS NO_INPUT_QUANTITY CM_RPM 7 0 8000 AXIS_PTS_REF AX_shift_rpm /end AXIS_DESCR
/end CHARACTERISTIC
/begin CHARACTERISTIC SHIFT_1d6ec0 "shift curve out-col @0x1d6ec0 (max 7250)" CURVE 0x1d6ece RL_CURVE_U16 0 CM_RPM 0 8000
 /begin AXIS_DESCR COM_AXIS NO_INPUT_QUANTITY CM_RPM 7 0 8000 AXIS_PTS_REF AX_shift_rpm /end AXIS_DESCR
/end CHARACTERISTIC
/begin CHARACTERISTIC SHIFT_1d6edc "shift curve out-col @0x1d6edc (max 7250)" CURVE 0x1d6eea RL_CURVE_U16 0 CM_RPM 0 8000
 /begin AXIS_DESCR COM_AXIS NO_INPUT_QUANTITY CM_RPM 7 0 8000 AXIS_PTS_REF AX_shift_rpm /end AXIS_DESCR
/end CHARACTERISTIC
/begin CHARACTERISTIC SHIFT_1d6ef8 "shift curve out-col @0x1d6ef8 (max 7250)" CURVE 0x1d6f06 RL_CURVE_U16 0 CM_RPM 0 8000
 /begin AXIS_DESCR COM_AXIS NO_INPUT_QUANTITY CM_RPM 7 0 8000 AXIS_PTS_REF AX_shift_rpm /end AXIS_DESCR
/end CHARACTERISTIC
/begin CHARACTERISTIC SHIFT_1d6f14 "shift curve out-col @0x1d6f14 (max 7250)" CURVE 0x1d6f22 RL_CURVE_U16 0 CM_RPM 0 8000
 /begin AXIS_DESCR COM_AXIS NO_INPUT_QUANTITY CM_RPM 7 0 8000 AXIS_PTS_REF AX_shift_rpm /end AXIS_DESCR
/end CHARACTERISTIC
/begin CHARACTERISTIC SHIFT_1d6f30 "shift curve out-col @0x1d6f30 (max 7250)" CURVE 0x1d6f3e RL_CURVE_U16 0 CM_RPM 0 8000
 /begin AXIS_DESCR COM_AXIS NO_INPUT_QUANTITY CM_RPM 7 0 8000 AXIS_PTS_REF AX_shift_rpm /end AXIS_DESCR
/end CHARACTERISTIC
/begin CHARACTERISTIC SHIFT_1d6f4c "shift curve out-col @0x1d6f4c (max 7250)" CURVE 0x1d6f5a RL_CURVE_U16 0 CM_RPM 0 8000
 /begin AXIS_DESCR COM_AXIS NO_INPUT_QUANTITY CM_RPM 7 0 8000 AXIS_PTS_REF AX_shift_rpm /end AXIS_DESCR
/end CHARACTERISTIC
/begin CHARACTERISTIC SHIFT_1d6f68 "shift curve out-col @0x1d6f68 (max 7250)" CURVE 0x1d6f76 RL_CURVE_U16 0 CM_RPM 0 8000
 /begin AXIS_DESCR COM_AXIS NO_INPUT_QUANTITY CM_RPM 7 0 8000 AXIS_PTS_REF AX_shift_rpm /end AXIS_DESCR
/end CHARACTERISTIC
/begin CHARACTERISTIC SHIFT_1d6f84 "shift curve out-col @0x1d6f84 (max 7250)" CURVE 0x1d6f92 RL_CURVE_U16 0 CM_RPM 0 8000
 /begin AXIS_DESCR COM_AXIS NO_INPUT_QUANTITY CM_RPM 7 0 8000 AXIS_PTS_REF AX_shift_rpm /end AXIS_DESCR
/end CHARACTERISTIC
/begin CHARACTERISTIC SHIFT_1d70d8 "shift curve out-col @0x1d70d8 (max 7252)" CURVE 0x1d70e6 RL_CURVE_U16 0 CM_RPM 0 8000
 /begin AXIS_DESCR COM_AXIS NO_INPUT_QUANTITY CM_RPM 7 0 8000 AXIS_PTS_REF AX_shift_rpm /end AXIS_DESCR
/end CHARACTERISTIC
/begin CHARACTERISTIC SHIFT_1d70f4 "shift curve out-col @0x1d70f4 (max 7250)" CURVE 0x1d7102 RL_CURVE_U16 0 CM_RPM 0 8000
 /begin AXIS_DESCR COM_AXIS NO_INPUT_QUANTITY CM_RPM 7 0 8000 AXIS_PTS_REF AX_shift_rpm /end AXIS_DESCR
/end CHARACTERISTIC
/begin CHARACTERISTIC SHIFT_1d7110 "shift curve out-col @0x1d7110 (max 7250)" CURVE 0x1d711e RL_CURVE_U16 0 CM_RPM 0 8000
 /begin AXIS_DESCR COM_AXIS NO_INPUT_QUANTITY CM_RPM 7 0 8000 AXIS_PTS_REF AX_shift_rpm /end AXIS_DESCR
/end CHARACTERISTIC
/begin CHARACTERISTIC SHIFT_1d7264 "shift curve out-col @0x1d7264 (max 7252)" CURVE 0x1d7272 RL_CURVE_U16 0 CM_RPM 0 8000
 /begin AXIS_DESCR COM_AXIS NO_INPUT_QUANTITY CM_RPM 7 0 8000 AXIS_PTS_REF AX_shift_rpm /end AXIS_DESCR
/end CHARACTERISTIC
/begin CHARACTERISTIC SHIFT_1d7280 "shift curve out-col @0x1d7280 (max 7250)" CURVE 0x1d728e RL_CURVE_U16 0 CM_RPM 0 8000
 /begin AXIS_DESCR COM_AXIS NO_INPUT_QUANTITY CM_RPM 7 0 8000 AXIS_PTS_REF AX_shift_rpm /end AXIS_DESCR
/end CHARACTERISTIC
/begin CHARACTERISTIC SHIFT_1d729c "shift curve out-col @0x1d729c (max 7250)" CURVE 0x1d72aa RL_CURVE_U16 0 CM_RPM 0 8000
 /begin AXIS_DESCR COM_AXIS NO_INPUT_QUANTITY CM_RPM 7 0 8000 AXIS_PTS_REF AX_shift_rpm /end AXIS_DESCR
/end CHARACTERISTIC
/begin CHARACTERISTIC SHIFT_1d73f0 "shift curve out-col @0x1d73f0 (max 7252)" CURVE 0x1d73fe RL_CURVE_U16 0 CM_RPM 0 8000
 /begin AXIS_DESCR COM_AXIS NO_INPUT_QUANTITY CM_RPM 7 0 8000 AXIS_PTS_REF AX_shift_rpm /end AXIS_DESCR
/end CHARACTERISTIC
/begin CHARACTERISTIC SHIFT_1d740c "shift curve out-col @0x1d740c (max 7250)" CURVE 0x1d741a RL_CURVE_U16 0 CM_RPM 0 8000
 /begin AXIS_DESCR COM_AXIS NO_INPUT_QUANTITY CM_RPM 7 0 8000 AXIS_PTS_REF AX_shift_rpm /end AXIS_DESCR
/end CHARACTERISTIC
/begin CHARACTERISTIC SHIFT_1d7428 "shift curve out-col @0x1d7428 (max 7250)" CURVE 0x1d7436 RL_CURVE_U16 0 CM_RPM 0 8000
 /begin AXIS_DESCR COM_AXIS NO_INPUT_QUANTITY CM_RPM 7 0 8000 AXIS_PTS_REF AX_shift_rpm /end AXIS_DESCR
/end CHARACTERISTIC
/begin CHARACTERISTIC SHIFT_1d757c "shift curve out-col @0x1d757c (max 7252)" CURVE 0x1d758a RL_CURVE_U16 0 CM_RPM 0 8000
 /begin AXIS_DESCR COM_AXIS NO_INPUT_QUANTITY CM_RPM 7 0 8000 AXIS_PTS_REF AX_shift_rpm /end AXIS_DESCR
/end CHARACTERISTIC
/begin CHARACTERISTIC SHIFT_1d7598 "shift curve out-col @0x1d7598 (max 7250)" CURVE 0x1d75a6 RL_CURVE_U16 0 CM_RPM 0 8000
 /begin AXIS_DESCR COM_AXIS NO_INPUT_QUANTITY CM_RPM 7 0 8000 AXIS_PTS_REF AX_shift_rpm /end AXIS_DESCR
/end CHARACTERISTIC
/begin CHARACTERISTIC SHIFT_1d75b4 "shift curve out-col @0x1d75b4 (max 7250)" CURVE 0x1d75c2 RL_CURVE_U16 0 CM_RPM 0 8000
 /begin AXIS_DESCR COM_AXIS NO_INPUT_QUANTITY CM_RPM 7 0 8000 AXIS_PTS_REF AX_shift_rpm /end AXIS_DESCR
/end CHARACTERISTIC
/begin CHARACTERISTIC SHIFT_1d7708 "shift curve out-col @0x1d7708 (max 7250)" CURVE 0x1d7716 RL_CURVE_U16 0 CM_RPM 0 8000
 /begin AXIS_DESCR COM_AXIS NO_INPUT_QUANTITY CM_RPM 7 0 8000 AXIS_PTS_REF AX_shift_rpm /end AXIS_DESCR
/end CHARACTERISTIC
/begin CHARACTERISTIC SHIFT_1d7724 "shift curve out-col @0x1d7724 (max 7250)" CURVE 0x1d7732 RL_CURVE_U16 0 CM_RPM 0 8000
 /begin AXIS_DESCR COM_AXIS NO_INPUT_QUANTITY CM_RPM 7 0 8000 AXIS_PTS_REF AX_shift_rpm /end AXIS_DESCR
/end CHARACTERISTIC
/begin CHARACTERISTIC SHIFT_1d7740 "shift curve out-col @0x1d7740 (max 7250)" CURVE 0x1d774e RL_CURVE_U16 0 CM_RPM 0 8000
 /begin AXIS_DESCR COM_AXIS NO_INPUT_QUANTITY CM_RPM 7 0 8000 AXIS_PTS_REF AX_shift_rpm /end AXIS_DESCR
/end CHARACTERISTIC
/begin CHARACTERISTIC SHIFT_1d7894 "shift curve out-col @0x1d7894 (max 7250)" CURVE 0x1d78a2 RL_CURVE_U16 0 CM_RPM 0 8000
 /begin AXIS_DESCR COM_AXIS NO_INPUT_QUANTITY CM_RPM 7 0 8000 AXIS_PTS_REF AX_shift_rpm /end AXIS_DESCR
/end CHARACTERISTIC
/begin CHARACTERISTIC SHIFT_1d78b0 "shift curve out-col @0x1d78b0 (max 7250)" CURVE 0x1d78be RL_CURVE_U16 0 CM_RPM 0 8000
 /begin AXIS_DESCR COM_AXIS NO_INPUT_QUANTITY CM_RPM 7 0 8000 AXIS_PTS_REF AX_shift_rpm /end AXIS_DESCR
/end CHARACTERISTIC
/begin CHARACTERISTIC SHIFT_1d78cc "shift curve out-col @0x1d78cc (max 7250)" CURVE 0x1d78da RL_CURVE_U16 0 CM_RPM 0 8000
 /begin AXIS_DESCR COM_AXIS NO_INPUT_QUANTITY CM_RPM 7 0 8000 AXIS_PTS_REF AX_shift_rpm /end AXIS_DESCR
/end CHARACTERISTIC
/begin CHARACTERISTIC SHIFT_1d7924 "shift curve out-col @0x1d7924 (max 7250)" CURVE 0x1d7932 RL_CURVE_U16 0 CM_RPM 0 8000
 /begin AXIS_DESCR COM_AXIS NO_INPUT_QUANTITY CM_RPM 7 0 8000 AXIS_PTS_REF AX_shift_rpm /end AXIS_DESCR
/end CHARACTERISTIC
/begin CHARACTERISTIC SHIFT_1d7940 "shift curve out-col @0x1d7940 (max 7250)" CURVE 0x1d794e RL_CURVE_U16 0 CM_RPM 0 8000
 /begin AXIS_DESCR COM_AXIS NO_INPUT_QUANTITY CM_RPM 7 0 8000 AXIS_PTS_REF AX_shift_rpm /end AXIS_DESCR
/end CHARACTERISTIC
/begin CHARACTERISTIC SHIFT_1d795c "shift curve out-col @0x1d795c (max 7250)" CURVE 0x1d796a RL_CURVE_U16 0 CM_RPM 0 8000
 /begin AXIS_DESCR COM_AXIS NO_INPUT_QUANTITY CM_RPM 7 0 8000 AXIS_PTS_REF AX_shift_rpm /end AXIS_DESCR
/end CHARACTERISTIC
/begin CHARACTERISTIC SHIFT_1d7978 "shift curve out-col @0x1d7978 (max 7250)" CURVE 0x1d7986 RL_CURVE_U16 0 CM_RPM 0 8000
 /begin AXIS_DESCR COM_AXIS NO_INPUT_QUANTITY CM_RPM 7 0 8000 AXIS_PTS_REF AX_shift_rpm /end AXIS_DESCR
/end CHARACTERISTIC
/begin CHARACTERISTIC SHIFT_1d7994 "shift curve out-col @0x1d7994 (max 7250)" CURVE 0x1d79a2 RL_CURVE_U16 0 CM_RPM 0 8000
 /begin AXIS_DESCR COM_AXIS NO_INPUT_QUANTITY CM_RPM 7 0 8000 AXIS_PTS_REF AX_shift_rpm /end AXIS_DESCR
/end CHARACTERISTIC
/begin CHARACTERISTIC SHIFT_1d79b0 "shift curve out-col @0x1d79b0 (max 7250)" CURVE 0x1d79be RL_CURVE_U16 0 CM_RPM 0 8000
 /begin AXIS_DESCR COM_AXIS NO_INPUT_QUANTITY CM_RPM 7 0 8000 AXIS_PTS_REF AX_shift_rpm /end AXIS_DESCR
/end CHARACTERISTIC
/begin CHARACTERISTIC SHIFT_1d79cc "shift curve out-col @0x1d79cc (max 7250)" CURVE 0x1d79da RL_CURVE_U16 0 CM_RPM 0 8000
 /begin AXIS_DESCR COM_AXIS NO_INPUT_QUANTITY CM_RPM 7 0 8000 AXIS_PTS_REF AX_shift_rpm /end AXIS_DESCR
/end CHARACTERISTIC
/begin CHARACTERISTIC SHIFT_1d79e8 "shift curve out-col @0x1d79e8 (max 7250)" CURVE 0x1d79f6 RL_CURVE_U16 0 CM_RPM 0 8000
 /begin AXIS_DESCR COM_AXIS NO_INPUT_QUANTITY CM_RPM 7 0 8000 AXIS_PTS_REF AX_shift_rpm /end AXIS_DESCR
/end CHARACTERISTIC
/begin CHARACTERISTIC SHIFT_1d7a04 "shift curve out-col @0x1d7a04 (max 7250)" CURVE 0x1d7a12 RL_CURVE_U16 0 CM_RPM 0 8000
 /begin AXIS_DESCR COM_AXIS NO_INPUT_QUANTITY CM_RPM 7 0 8000 AXIS_PTS_REF AX_shift_rpm /end AXIS_DESCR
/end CHARACTERISTIC
/begin CHARACTERISTIC SHIFT_1d7a20 "shift curve out-col @0x1d7a20 (max 7250)" CURVE 0x1d7a2e RL_CURVE_U16 0 CM_RPM 0 8000
 /begin AXIS_DESCR COM_AXIS NO_INPUT_QUANTITY CM_RPM 7 0 8000 AXIS_PTS_REF AX_shift_rpm /end AXIS_DESCR
/end CHARACTERISTIC
/begin CHARACTERISTIC SHIFT_1d7a3c "shift curve out-col @0x1d7a3c (max 7250)" CURVE 0x1d7a4a RL_CURVE_U16 0 CM_RPM 0 8000
 /begin AXIS_DESCR COM_AXIS NO_INPUT_QUANTITY CM_RPM 7 0 8000 AXIS_PTS_REF AX_shift_rpm /end AXIS_DESCR
/end CHARACTERISTIC
/begin CHARACTERISTIC SHIFT_1d7a58 "shift curve out-col @0x1d7a58 (max 7250)" CURVE 0x1d7a66 RL_CURVE_U16 0 CM_RPM 0 8000
 /begin AXIS_DESCR COM_AXIS NO_INPUT_QUANTITY CM_RPM 7 0 8000 AXIS_PTS_REF AX_shift_rpm /end AXIS_DESCR
/end CHARACTERISTIC
/begin CHARACTERISTIC SHIFT_1d7ab0 "shift curve out-col @0x1d7ab0 (max 7250)" CURVE 0x1d7abe RL_CURVE_U16 0 CM_RPM 0 8000
 /begin AXIS_DESCR COM_AXIS NO_INPUT_QUANTITY CM_RPM 7 0 8000 AXIS_PTS_REF AX_shift_rpm /end AXIS_DESCR
/end CHARACTERISTIC
/begin CHARACTERISTIC SHIFT_1d7acc "shift curve out-col @0x1d7acc (max 7250)" CURVE 0x1d7ada RL_CURVE_U16 0 CM_RPM 0 8000
 /begin AXIS_DESCR COM_AXIS NO_INPUT_QUANTITY CM_RPM 7 0 8000 AXIS_PTS_REF AX_shift_rpm /end AXIS_DESCR
/end CHARACTERISTIC
/begin CHARACTERISTIC SHIFT_1d7ae8 "shift curve out-col @0x1d7ae8 (max 7250)" CURVE 0x1d7af6 RL_CURVE_U16 0 CM_RPM 0 8000
 /begin AXIS_DESCR COM_AXIS NO_INPUT_QUANTITY CM_RPM 7 0 8000 AXIS_PTS_REF AX_shift_rpm /end AXIS_DESCR
/end CHARACTERISTIC
/begin CHARACTERISTIC SHIFT_1d7b04 "shift curve out-col @0x1d7b04 (max 7250)" CURVE 0x1d7b12 RL_CURVE_U16 0 CM_RPM 0 8000
 /begin AXIS_DESCR COM_AXIS NO_INPUT_QUANTITY CM_RPM 7 0 8000 AXIS_PTS_REF AX_shift_rpm /end AXIS_DESCR
/end CHARACTERISTIC
/begin CHARACTERISTIC SHIFT_1d7b20 "shift curve out-col @0x1d7b20 (max 7250)" CURVE 0x1d7b2e RL_CURVE_U16 0 CM_RPM 0 8000
 /begin AXIS_DESCR COM_AXIS NO_INPUT_QUANTITY CM_RPM 7 0 8000 AXIS_PTS_REF AX_shift_rpm /end AXIS_DESCR
/end CHARACTERISTIC
/begin CHARACTERISTIC SHIFT_1d7b3c "shift curve out-col @0x1d7b3c (max 7250)" CURVE 0x1d7b4a RL_CURVE_U16 0 CM_RPM 0 8000
 /begin AXIS_DESCR COM_AXIS NO_INPUT_QUANTITY CM_RPM 7 0 8000 AXIS_PTS_REF AX_shift_rpm /end AXIS_DESCR
/end CHARACTERISTIC
/begin CHARACTERISTIC SHIFT_1d7b58 "shift curve out-col @0x1d7b58 (max 7250)" CURVE 0x1d7b66 RL_CURVE_U16 0 CM_RPM 0 8000
 /begin AXIS_DESCR COM_AXIS NO_INPUT_QUANTITY CM_RPM 7 0 8000 AXIS_PTS_REF AX_shift_rpm /end AXIS_DESCR
/end CHARACTERISTIC
/begin CHARACTERISTIC SHIFT_1d7b74 "shift curve out-col @0x1d7b74 (max 7250)" CURVE 0x1d7b82 RL_CURVE_U16 0 CM_RPM 0 8000
 /begin AXIS_DESCR COM_AXIS NO_INPUT_QUANTITY CM_RPM 7 0 8000 AXIS_PTS_REF AX_shift_rpm /end AXIS_DESCR
/end CHARACTERISTIC
/begin CHARACTERISTIC SHIFT_1d7b90 "shift curve out-col @0x1d7b90 (max 7250)" CURVE 0x1d7b9e RL_CURVE_U16 0 CM_RPM 0 8000
 /begin AXIS_DESCR COM_AXIS NO_INPUT_QUANTITY CM_RPM 7 0 8000 AXIS_PTS_REF AX_shift_rpm /end AXIS_DESCR
/end CHARACTERISTIC
/begin CHARACTERISTIC SHIFT_1d7bac "shift curve out-col @0x1d7bac (max 7250)" CURVE 0x1d7bba RL_CURVE_U16 0 CM_RPM 0 8000
 /begin AXIS_DESCR COM_AXIS NO_INPUT_QUANTITY CM_RPM 7 0 8000 AXIS_PTS_REF AX_shift_rpm /end AXIS_DESCR
/end CHARACTERISTIC
/begin CHARACTERISTIC SHIFT_1d7bc8 "shift curve out-col @0x1d7bc8 (max 7250)" CURVE 0x1d7bd6 RL_CURVE_U16 0 CM_RPM 0 8000
 /begin AXIS_DESCR COM_AXIS NO_INPUT_QUANTITY CM_RPM 7 0 8000 AXIS_PTS_REF AX_shift_rpm /end AXIS_DESCR
/end CHARACTERISTIC
/begin CHARACTERISTIC SHIFT_1d7be4 "shift curve out-col @0x1d7be4 (max 7250)" CURVE 0x1d7bf2 RL_CURVE_U16 0 CM_RPM 0 8000
 /begin AXIS_DESCR COM_AXIS NO_INPUT_QUANTITY CM_RPM 7 0 8000 AXIS_PTS_REF AX_shift_rpm /end AXIS_DESCR
/end CHARACTERISTIC
/begin CHARACTERISTIC SHIFT_1d7c3c "shift curve out-col @0x1d7c3c (max 1580)" CURVE 0x1d7c4a RL_CURVE_U16 0 CM_RPM 0 8000
 /begin AXIS_DESCR COM_AXIS NO_INPUT_QUANTITY CM_RPM 7 0 8000 AXIS_PTS_REF AX_shift_rpm /end AXIS_DESCR
/end CHARACTERISTIC
/begin CHARACTERISTIC SHIFT_1d7c58 "shift curve out-col @0x1d7c58 (max 1580)" CURVE 0x1d7c66 RL_CURVE_U16 0 CM_RPM 0 8000
 /begin AXIS_DESCR COM_AXIS NO_INPUT_QUANTITY CM_RPM 7 0 8000 AXIS_PTS_REF AX_shift_rpm /end AXIS_DESCR
/end CHARACTERISTIC
/begin CHARACTERISTIC SHIFT_1d7c74 "shift curve out-col @0x1d7c74 (max 1580)" CURVE 0x1d7c82 RL_CURVE_U16 0 CM_RPM 0 8000
 /begin AXIS_DESCR COM_AXIS NO_INPUT_QUANTITY CM_RPM 7 0 8000 AXIS_PTS_REF AX_shift_rpm /end AXIS_DESCR
/end CHARACTERISTIC
/begin CHARACTERISTIC SHIFT_1d7c90 "shift curve out-col @0x1d7c90 (max 1750)" CURVE 0x1d7c9e RL_CURVE_U16 0 CM_RPM 0 8000
 /begin AXIS_DESCR COM_AXIS NO_INPUT_QUANTITY CM_RPM 7 0 8000 AXIS_PTS_REF AX_shift_rpm /end AXIS_DESCR
/end CHARACTERISTIC
/begin CHARACTERISTIC SHIFT_1d7cac "shift curve out-col @0x1d7cac (max 2050)" CURVE 0x1d7cba RL_CURVE_U16 0 CM_RPM 0 8000
 /begin AXIS_DESCR COM_AXIS NO_INPUT_QUANTITY CM_RPM 7 0 8000 AXIS_PTS_REF AX_shift_rpm /end AXIS_DESCR
/end CHARACTERISTIC
/begin CHARACTERISTIC SHIFT_1d7cc8 "shift curve out-col @0x1d7cc8 (max 2800)" CURVE 0x1d7cd6 RL_CURVE_U16 0 CM_RPM 0 8000
 /begin AXIS_DESCR COM_AXIS NO_INPUT_QUANTITY CM_RPM 7 0 8000 AXIS_PTS_REF AX_shift_rpm /end AXIS_DESCR
/end CHARACTERISTIC
/begin CHARACTERISTIC SHIFT_1d7ce4 "shift curve out-col @0x1d7ce4 (max 4200)" CURVE 0x1d7cf2 RL_CURVE_U16 0 CM_RPM 0 8000
 /begin AXIS_DESCR COM_AXIS NO_INPUT_QUANTITY CM_RPM 7 0 8000 AXIS_PTS_REF AX_shift_rpm /end AXIS_DESCR
/end CHARACTERISTIC
/begin CHARACTERISTIC SHIFT_1d7d00 "shift curve out-col @0x1d7d00 (max 5500)" CURVE 0x1d7d0e RL_CURVE_U16 0 CM_RPM 0 8000
 /begin AXIS_DESCR COM_AXIS NO_INPUT_QUANTITY CM_RPM 7 0 8000 AXIS_PTS_REF AX_shift_rpm /end AXIS_DESCR
/end CHARACTERISTIC
/begin CHARACTERISTIC SHIFT_1d7d1c "shift curve out-col @0x1d7d1c (max 5800)" CURVE 0x1d7d2a RL_CURVE_U16 0 CM_RPM 0 8000
 /begin AXIS_DESCR COM_AXIS NO_INPUT_QUANTITY CM_RPM 7 0 8000 AXIS_PTS_REF AX_shift_rpm /end AXIS_DESCR
/end CHARACTERISTIC
/begin CHARACTERISTIC SHIFT_1d7d38 "shift curve out-col @0x1d7d38 (max 6000)" CURVE 0x1d7d46 RL_CURVE_U16 0 CM_RPM 0 8000
 /begin AXIS_DESCR COM_AXIS NO_INPUT_QUANTITY CM_RPM 7 0 8000 AXIS_PTS_REF AX_shift_rpm /end AXIS_DESCR
/end CHARACTERISTIC
/begin CHARACTERISTIC SHIFT_1d7d54 "shift curve out-col @0x1d7d54 (max 6000)" CURVE 0x1d7d62 RL_CURVE_U16 0 CM_RPM 0 8000
 /begin AXIS_DESCR COM_AXIS NO_INPUT_QUANTITY CM_RPM 7 0 8000 AXIS_PTS_REF AX_shift_rpm /end AXIS_DESCR
/end CHARACTERISTIC
/begin CHARACTERISTIC SHIFT_1d7d70 "shift curve out-col @0x1d7d70 (max 7250)" CURVE 0x1d7d7e RL_CURVE_U16 0 CM_RPM 0 8000
 /begin AXIS_DESCR COM_AXIS NO_INPUT_QUANTITY CM_RPM 7 0 8000 AXIS_PTS_REF AX_shift_rpm /end AXIS_DESCR
/end CHARACTERISTIC
/begin CHARACTERISTIC SHIFT_1d7dc8 "shift curve out-col @0x1d7dc8 (max 1580)" CURVE 0x1d7dd6 RL_CURVE_U16 0 CM_RPM 0 8000
 /begin AXIS_DESCR COM_AXIS NO_INPUT_QUANTITY CM_RPM 7 0 8000 AXIS_PTS_REF AX_shift_rpm /end AXIS_DESCR
/end CHARACTERISTIC
/begin CHARACTERISTIC SHIFT_1d7de4 "shift curve out-col @0x1d7de4 (max 1580)" CURVE 0x1d7df2 RL_CURVE_U16 0 CM_RPM 0 8000
 /begin AXIS_DESCR COM_AXIS NO_INPUT_QUANTITY CM_RPM 7 0 8000 AXIS_PTS_REF AX_shift_rpm /end AXIS_DESCR
/end CHARACTERISTIC
/begin CHARACTERISTIC SHIFT_1d7e00 "shift curve out-col @0x1d7e00 (max 1580)" CURVE 0x1d7e0e RL_CURVE_U16 0 CM_RPM 0 8000
 /begin AXIS_DESCR COM_AXIS NO_INPUT_QUANTITY CM_RPM 7 0 8000 AXIS_PTS_REF AX_shift_rpm /end AXIS_DESCR
/end CHARACTERISTIC
/begin CHARACTERISTIC SHIFT_1d7e1c "shift curve out-col @0x1d7e1c (max 1750)" CURVE 0x1d7e2a RL_CURVE_U16 0 CM_RPM 0 8000
 /begin AXIS_DESCR COM_AXIS NO_INPUT_QUANTITY CM_RPM 7 0 8000 AXIS_PTS_REF AX_shift_rpm /end AXIS_DESCR
/end CHARACTERISTIC
/begin CHARACTERISTIC SHIFT_1d7e38 "shift curve out-col @0x1d7e38 (max 2050)" CURVE 0x1d7e46 RL_CURVE_U16 0 CM_RPM 0 8000
 /begin AXIS_DESCR COM_AXIS NO_INPUT_QUANTITY CM_RPM 7 0 8000 AXIS_PTS_REF AX_shift_rpm /end AXIS_DESCR
/end CHARACTERISTIC
/begin CHARACTERISTIC SHIFT_1d7e54 "shift curve out-col @0x1d7e54 (max 2800)" CURVE 0x1d7e62 RL_CURVE_U16 0 CM_RPM 0 8000
 /begin AXIS_DESCR COM_AXIS NO_INPUT_QUANTITY CM_RPM 7 0 8000 AXIS_PTS_REF AX_shift_rpm /end AXIS_DESCR
/end CHARACTERISTIC
/begin CHARACTERISTIC SHIFT_1d7e70 "shift curve out-col @0x1d7e70 (max 4200)" CURVE 0x1d7e7e RL_CURVE_U16 0 CM_RPM 0 8000
 /begin AXIS_DESCR COM_AXIS NO_INPUT_QUANTITY CM_RPM 7 0 8000 AXIS_PTS_REF AX_shift_rpm /end AXIS_DESCR
/end CHARACTERISTIC
/begin CHARACTERISTIC SHIFT_1d7e8c "shift curve out-col @0x1d7e8c (max 5500)" CURVE 0x1d7e9a RL_CURVE_U16 0 CM_RPM 0 8000
 /begin AXIS_DESCR COM_AXIS NO_INPUT_QUANTITY CM_RPM 7 0 8000 AXIS_PTS_REF AX_shift_rpm /end AXIS_DESCR
/end CHARACTERISTIC
/begin CHARACTERISTIC SHIFT_1d7ea8 "shift curve out-col @0x1d7ea8 (max 5800)" CURVE 0x1d7eb6 RL_CURVE_U16 0 CM_RPM 0 8000
 /begin AXIS_DESCR COM_AXIS NO_INPUT_QUANTITY CM_RPM 7 0 8000 AXIS_PTS_REF AX_shift_rpm /end AXIS_DESCR
/end CHARACTERISTIC
/begin CHARACTERISTIC SHIFT_1d7ec4 "shift curve out-col @0x1d7ec4 (max 6000)" CURVE 0x1d7ed2 RL_CURVE_U16 0 CM_RPM 0 8000
 /begin AXIS_DESCR COM_AXIS NO_INPUT_QUANTITY CM_RPM 7 0 8000 AXIS_PTS_REF AX_shift_rpm /end AXIS_DESCR
/end CHARACTERISTIC
/begin CHARACTERISTIC SHIFT_1d7ee0 "shift curve out-col @0x1d7ee0 (max 6000)" CURVE 0x1d7eee RL_CURVE_U16 0 CM_RPM 0 8000
 /begin AXIS_DESCR COM_AXIS NO_INPUT_QUANTITY CM_RPM 7 0 8000 AXIS_PTS_REF AX_shift_rpm /end AXIS_DESCR
/end CHARACTERISTIC
/begin CHARACTERISTIC SHIFT_1d7efc "shift curve out-col @0x1d7efc (max 7250)" CURVE 0x1d7f0a RL_CURVE_U16 0 CM_RPM 0 8000
 /begin AXIS_DESCR COM_AXIS NO_INPUT_QUANTITY CM_RPM 7 0 8000 AXIS_PTS_REF AX_shift_rpm /end AXIS_DESCR
/end CHARACTERISTIC
/begin CHARACTERISTIC SHIFT_1d826c "shift curve out-col @0x1d826c (max 1580)" CURVE 0x1d827a RL_CURVE_U16 0 CM_RPM 0 8000
 /begin AXIS_DESCR COM_AXIS NO_INPUT_QUANTITY CM_RPM 7 0 8000 AXIS_PTS_REF AX_shift_rpm /end AXIS_DESCR
/end CHARACTERISTIC
/begin CHARACTERISTIC SHIFT_1d8288 "shift curve out-col @0x1d8288 (max 1580)" CURVE 0x1d8296 RL_CURVE_U16 0 CM_RPM 0 8000
 /begin AXIS_DESCR COM_AXIS NO_INPUT_QUANTITY CM_RPM 7 0 8000 AXIS_PTS_REF AX_shift_rpm /end AXIS_DESCR
/end CHARACTERISTIC
/begin CHARACTERISTIC SHIFT_1d82a4 "shift curve out-col @0x1d82a4 (max 1580)" CURVE 0x1d82b2 RL_CURVE_U16 0 CM_RPM 0 8000
 /begin AXIS_DESCR COM_AXIS NO_INPUT_QUANTITY CM_RPM 7 0 8000 AXIS_PTS_REF AX_shift_rpm /end AXIS_DESCR
/end CHARACTERISTIC
/begin CHARACTERISTIC SHIFT_1d82c0 "shift curve out-col @0x1d82c0 (max 1580)" CURVE 0x1d82ce RL_CURVE_U16 0 CM_RPM 0 8000
 /begin AXIS_DESCR COM_AXIS NO_INPUT_QUANTITY CM_RPM 7 0 8000 AXIS_PTS_REF AX_shift_rpm /end AXIS_DESCR
/end CHARACTERISTIC
/begin CHARACTERISTIC SHIFT_1d82dc "shift curve out-col @0x1d82dc (max 1580)" CURVE 0x1d82ea RL_CURVE_U16 0 CM_RPM 0 8000
 /begin AXIS_DESCR COM_AXIS NO_INPUT_QUANTITY CM_RPM 7 0 8000 AXIS_PTS_REF AX_shift_rpm /end AXIS_DESCR
/end CHARACTERISTIC
/begin CHARACTERISTIC SHIFT_1d82f8 "shift curve out-col @0x1d82f8 (max 1580)" CURVE 0x1d8306 RL_CURVE_U16 0 CM_RPM 0 8000
 /begin AXIS_DESCR COM_AXIS NO_INPUT_QUANTITY CM_RPM 7 0 8000 AXIS_PTS_REF AX_shift_rpm /end AXIS_DESCR
/end CHARACTERISTIC
/begin CHARACTERISTIC SHIFT_1d8314 "shift curve out-col @0x1d8314 (max 1580)" CURVE 0x1d8322 RL_CURVE_U16 0 CM_RPM 0 8000
 /begin AXIS_DESCR COM_AXIS NO_INPUT_QUANTITY CM_RPM 7 0 8000 AXIS_PTS_REF AX_shift_rpm /end AXIS_DESCR
/end CHARACTERISTIC
/begin CHARACTERISTIC SHIFT_1d8330 "shift curve out-col @0x1d8330 (max 1580)" CURVE 0x1d833e RL_CURVE_U16 0 CM_RPM 0 8000
 /begin AXIS_DESCR COM_AXIS NO_INPUT_QUANTITY CM_RPM 7 0 8000 AXIS_PTS_REF AX_shift_rpm /end AXIS_DESCR
/end CHARACTERISTIC
/begin CHARACTERISTIC SHIFT_1d834c "shift curve out-col @0x1d834c (max 1580)" CURVE 0x1d835a RL_CURVE_U16 0 CM_RPM 0 8000
 /begin AXIS_DESCR COM_AXIS NO_INPUT_QUANTITY CM_RPM 7 0 8000 AXIS_PTS_REF AX_shift_rpm /end AXIS_DESCR
/end CHARACTERISTIC
/begin CHARACTERISTIC SHIFT_1d8368 "shift curve out-col @0x1d8368 (max 1580)" CURVE 0x1d8376 RL_CURVE_U16 0 CM_RPM 0 8000
 /begin AXIS_DESCR COM_AXIS NO_INPUT_QUANTITY CM_RPM 7 0 8000 AXIS_PTS_REF AX_shift_rpm /end AXIS_DESCR
/end CHARACTERISTIC
/begin CHARACTERISTIC SHIFT_1d8384 "shift curve out-col @0x1d8384 (max 1580)" CURVE 0x1d8392 RL_CURVE_U16 0 CM_RPM 0 8000
 /begin AXIS_DESCR COM_AXIS NO_INPUT_QUANTITY CM_RPM 7 0 8000 AXIS_PTS_REF AX_shift_rpm /end AXIS_DESCR
/end CHARACTERISTIC
/begin CHARACTERISTIC SHIFT_1d83a0 "shift curve out-col @0x1d83a0 (max 7250)" CURVE 0x1d83ae RL_CURVE_U16 0 CM_RPM 0 8000
 /begin AXIS_DESCR COM_AXIS NO_INPUT_QUANTITY CM_RPM 7 0 8000 AXIS_PTS_REF AX_shift_rpm /end AXIS_DESCR
/end CHARACTERISTIC
/begin CHARACTERISTIC SHIFT_1d83f8 "shift curve out-col @0x1d83f8 (max 1580)" CURVE 0x1d8406 RL_CURVE_U16 0 CM_RPM 0 8000
 /begin AXIS_DESCR COM_AXIS NO_INPUT_QUANTITY CM_RPM 7 0 8000 AXIS_PTS_REF AX_shift_rpm /end AXIS_DESCR
/end CHARACTERISTIC
/begin CHARACTERISTIC SHIFT_1d8414 "shift curve out-col @0x1d8414 (max 1580)" CURVE 0x1d8422 RL_CURVE_U16 0 CM_RPM 0 8000
 /begin AXIS_DESCR COM_AXIS NO_INPUT_QUANTITY CM_RPM 7 0 8000 AXIS_PTS_REF AX_shift_rpm /end AXIS_DESCR
/end CHARACTERISTIC
/begin CHARACTERISTIC SHIFT_1d8430 "shift curve out-col @0x1d8430 (max 1580)" CURVE 0x1d843e RL_CURVE_U16 0 CM_RPM 0 8000
 /begin AXIS_DESCR COM_AXIS NO_INPUT_QUANTITY CM_RPM 7 0 8000 AXIS_PTS_REF AX_shift_rpm /end AXIS_DESCR
/end CHARACTERISTIC
/begin CHARACTERISTIC SHIFT_1d844c "shift curve out-col @0x1d844c (max 1580)" CURVE 0x1d845a RL_CURVE_U16 0 CM_RPM 0 8000
 /begin AXIS_DESCR COM_AXIS NO_INPUT_QUANTITY CM_RPM 7 0 8000 AXIS_PTS_REF AX_shift_rpm /end AXIS_DESCR
/end CHARACTERISTIC
/begin CHARACTERISTIC SHIFT_1d8468 "shift curve out-col @0x1d8468 (max 1580)" CURVE 0x1d8476 RL_CURVE_U16 0 CM_RPM 0 8000
 /begin AXIS_DESCR COM_AXIS NO_INPUT_QUANTITY CM_RPM 7 0 8000 AXIS_PTS_REF AX_shift_rpm /end AXIS_DESCR
/end CHARACTERISTIC
/begin CHARACTERISTIC SHIFT_1d8484 "shift curve out-col @0x1d8484 (max 1580)" CURVE 0x1d8492 RL_CURVE_U16 0 CM_RPM 0 8000
 /begin AXIS_DESCR COM_AXIS NO_INPUT_QUANTITY CM_RPM 7 0 8000 AXIS_PTS_REF AX_shift_rpm /end AXIS_DESCR
/end CHARACTERISTIC
/begin CHARACTERISTIC SHIFT_1d84a0 "shift curve out-col @0x1d84a0 (max 1580)" CURVE 0x1d84ae RL_CURVE_U16 0 CM_RPM 0 8000
 /begin AXIS_DESCR COM_AXIS NO_INPUT_QUANTITY CM_RPM 7 0 8000 AXIS_PTS_REF AX_shift_rpm /end AXIS_DESCR
/end CHARACTERISTIC
/begin CHARACTERISTIC SHIFT_1d84bc "shift curve out-col @0x1d84bc (max 1580)" CURVE 0x1d84ca RL_CURVE_U16 0 CM_RPM 0 8000
 /begin AXIS_DESCR COM_AXIS NO_INPUT_QUANTITY CM_RPM 7 0 8000 AXIS_PTS_REF AX_shift_rpm /end AXIS_DESCR
/end CHARACTERISTIC
/begin CHARACTERISTIC SHIFT_1d84d8 "shift curve out-col @0x1d84d8 (max 1580)" CURVE 0x1d84e6 RL_CURVE_U16 0 CM_RPM 0 8000
 /begin AXIS_DESCR COM_AXIS NO_INPUT_QUANTITY CM_RPM 7 0 8000 AXIS_PTS_REF AX_shift_rpm /end AXIS_DESCR
/end CHARACTERISTIC
/begin CHARACTERISTIC SHIFT_1d84f4 "shift curve out-col @0x1d84f4 (max 1580)" CURVE 0x1d8502 RL_CURVE_U16 0 CM_RPM 0 8000
 /begin AXIS_DESCR COM_AXIS NO_INPUT_QUANTITY CM_RPM 7 0 8000 AXIS_PTS_REF AX_shift_rpm /end AXIS_DESCR
/end CHARACTERISTIC
/begin CHARACTERISTIC SHIFT_1d8510 "shift curve out-col @0x1d8510 (max 1580)" CURVE 0x1d851e RL_CURVE_U16 0 CM_RPM 0 8000
 /begin AXIS_DESCR COM_AXIS NO_INPUT_QUANTITY CM_RPM 7 0 8000 AXIS_PTS_REF AX_shift_rpm /end AXIS_DESCR
/end CHARACTERISTIC
/begin CHARACTERISTIC SHIFT_1d852c "shift curve out-col @0x1d852c (max 7250)" CURVE 0x1d853a RL_CURVE_U16 0 CM_RPM 0 8000
 /begin AXIS_DESCR COM_AXIS NO_INPUT_QUANTITY CM_RPM 7 0 8000 AXIS_PTS_REF AX_shift_rpm /end AXIS_DESCR
/end CHARACTERISTIC
/begin CHARACTERISTIC SHIFT_1d8584 "shift curve out-col @0x1d8584 (max 1350)" CURVE 0x1d8592 RL_CURVE_U16 0 CM_RPM 0 8000
 /begin AXIS_DESCR COM_AXIS NO_INPUT_QUANTITY CM_RPM 7 0 8000 AXIS_PTS_REF AX_shift_rpm /end AXIS_DESCR
/end CHARACTERISTIC
/begin CHARACTERISTIC SHIFT_1d85a0 "shift curve out-col @0x1d85a0 (max 1350)" CURVE 0x1d85ae RL_CURVE_U16 0 CM_RPM 0 8000
 /begin AXIS_DESCR COM_AXIS NO_INPUT_QUANTITY CM_RPM 7 0 8000 AXIS_PTS_REF AX_shift_rpm /end AXIS_DESCR
/end CHARACTERISTIC
/begin CHARACTERISTIC SHIFT_1d85bc "shift curve out-col @0x1d85bc (max 1350)" CURVE 0x1d85ca RL_CURVE_U16 0 CM_RPM 0 8000
 /begin AXIS_DESCR COM_AXIS NO_INPUT_QUANTITY CM_RPM 7 0 8000 AXIS_PTS_REF AX_shift_rpm /end AXIS_DESCR
/end CHARACTERISTIC
/begin CHARACTERISTIC SHIFT_1d85d8 "shift curve out-col @0x1d85d8 (max 1350)" CURVE 0x1d85e6 RL_CURVE_U16 0 CM_RPM 0 8000
 /begin AXIS_DESCR COM_AXIS NO_INPUT_QUANTITY CM_RPM 7 0 8000 AXIS_PTS_REF AX_shift_rpm /end AXIS_DESCR
/end CHARACTERISTIC
/begin CHARACTERISTIC SHIFT_1d85f4 "shift curve out-col @0x1d85f4 (max 1350)" CURVE 0x1d8602 RL_CURVE_U16 0 CM_RPM 0 8000
 /begin AXIS_DESCR COM_AXIS NO_INPUT_QUANTITY CM_RPM 7 0 8000 AXIS_PTS_REF AX_shift_rpm /end AXIS_DESCR
/end CHARACTERISTIC
/begin CHARACTERISTIC SHIFT_1d8610 "shift curve out-col @0x1d8610 (max 1350)" CURVE 0x1d861e RL_CURVE_U16 0 CM_RPM 0 8000
 /begin AXIS_DESCR COM_AXIS NO_INPUT_QUANTITY CM_RPM 7 0 8000 AXIS_PTS_REF AX_shift_rpm /end AXIS_DESCR
/end CHARACTERISTIC
/begin CHARACTERISTIC SHIFT_1d862c "shift curve out-col @0x1d862c (max 1350)" CURVE 0x1d863a RL_CURVE_U16 0 CM_RPM 0 8000
 /begin AXIS_DESCR COM_AXIS NO_INPUT_QUANTITY CM_RPM 7 0 8000 AXIS_PTS_REF AX_shift_rpm /end AXIS_DESCR
/end CHARACTERISTIC
/begin CHARACTERISTIC SHIFT_1d8648 "shift curve out-col @0x1d8648 (max 1350)" CURVE 0x1d8656 RL_CURVE_U16 0 CM_RPM 0 8000
 /begin AXIS_DESCR COM_AXIS NO_INPUT_QUANTITY CM_RPM 7 0 8000 AXIS_PTS_REF AX_shift_rpm /end AXIS_DESCR
/end CHARACTERISTIC
/begin CHARACTERISTIC SHIFT_1d8664 "shift curve out-col @0x1d8664 (max 1350)" CURVE 0x1d8672 RL_CURVE_U16 0 CM_RPM 0 8000
 /begin AXIS_DESCR COM_AXIS NO_INPUT_QUANTITY CM_RPM 7 0 8000 AXIS_PTS_REF AX_shift_rpm /end AXIS_DESCR
/end CHARACTERISTIC
/begin CHARACTERISTIC SHIFT_1d8680 "shift curve out-col @0x1d8680 (max 1350)" CURVE 0x1d868e RL_CURVE_U16 0 CM_RPM 0 8000
 /begin AXIS_DESCR COM_AXIS NO_INPUT_QUANTITY CM_RPM 7 0 8000 AXIS_PTS_REF AX_shift_rpm /end AXIS_DESCR
/end CHARACTERISTIC
/begin CHARACTERISTIC SHIFT_1d869c "shift curve out-col @0x1d869c (max 1350)" CURVE 0x1d86aa RL_CURVE_U16 0 CM_RPM 0 8000
 /begin AXIS_DESCR COM_AXIS NO_INPUT_QUANTITY CM_RPM 7 0 8000 AXIS_PTS_REF AX_shift_rpm /end AXIS_DESCR
/end CHARACTERISTIC
/begin CHARACTERISTIC SHIFT_1d86b8 "shift curve out-col @0x1d86b8 (max 7250)" CURVE 0x1d86c6 RL_CURVE_U16 0 CM_RPM 0 8000
 /begin AXIS_DESCR COM_AXIS NO_INPUT_QUANTITY CM_RPM 7 0 8000 AXIS_PTS_REF AX_shift_rpm /end AXIS_DESCR
/end CHARACTERISTIC
/begin CHARACTERISTIC SHIFT_1d8710 "shift curve out-col @0x1d8710 (max 1350)" CURVE 0x1d871e RL_CURVE_U16 0 CM_RPM 0 8000
 /begin AXIS_DESCR COM_AXIS NO_INPUT_QUANTITY CM_RPM 7 0 8000 AXIS_PTS_REF AX_shift_rpm /end AXIS_DESCR
/end CHARACTERISTIC
/begin CHARACTERISTIC SHIFT_1d872c "shift curve out-col @0x1d872c (max 1350)" CURVE 0x1d873a RL_CURVE_U16 0 CM_RPM 0 8000
 /begin AXIS_DESCR COM_AXIS NO_INPUT_QUANTITY CM_RPM 7 0 8000 AXIS_PTS_REF AX_shift_rpm /end AXIS_DESCR
/end CHARACTERISTIC
/begin CHARACTERISTIC SHIFT_1d8748 "shift curve out-col @0x1d8748 (max 1350)" CURVE 0x1d8756 RL_CURVE_U16 0 CM_RPM 0 8000
 /begin AXIS_DESCR COM_AXIS NO_INPUT_QUANTITY CM_RPM 7 0 8000 AXIS_PTS_REF AX_shift_rpm /end AXIS_DESCR
/end CHARACTERISTIC
/begin CHARACTERISTIC SHIFT_1d8764 "shift curve out-col @0x1d8764 (max 1350)" CURVE 0x1d8772 RL_CURVE_U16 0 CM_RPM 0 8000
 /begin AXIS_DESCR COM_AXIS NO_INPUT_QUANTITY CM_RPM 7 0 8000 AXIS_PTS_REF AX_shift_rpm /end AXIS_DESCR
/end CHARACTERISTIC
/begin CHARACTERISTIC SHIFT_1d8780 "shift curve out-col @0x1d8780 (max 1350)" CURVE 0x1d878e RL_CURVE_U16 0 CM_RPM 0 8000
 /begin AXIS_DESCR COM_AXIS NO_INPUT_QUANTITY CM_RPM 7 0 8000 AXIS_PTS_REF AX_shift_rpm /end AXIS_DESCR
/end CHARACTERISTIC
/begin CHARACTERISTIC SHIFT_1d879c "shift curve out-col @0x1d879c (max 1350)" CURVE 0x1d87aa RL_CURVE_U16 0 CM_RPM 0 8000
 /begin AXIS_DESCR COM_AXIS NO_INPUT_QUANTITY CM_RPM 7 0 8000 AXIS_PTS_REF AX_shift_rpm /end AXIS_DESCR
/end CHARACTERISTIC
/begin CHARACTERISTIC SHIFT_1d87b8 "shift curve out-col @0x1d87b8 (max 1350)" CURVE 0x1d87c6 RL_CURVE_U16 0 CM_RPM 0 8000
 /begin AXIS_DESCR COM_AXIS NO_INPUT_QUANTITY CM_RPM 7 0 8000 AXIS_PTS_REF AX_shift_rpm /end AXIS_DESCR
/end CHARACTERISTIC
/begin CHARACTERISTIC SHIFT_1d87d4 "shift curve out-col @0x1d87d4 (max 1350)" CURVE 0x1d87e2 RL_CURVE_U16 0 CM_RPM 0 8000
 /begin AXIS_DESCR COM_AXIS NO_INPUT_QUANTITY CM_RPM 7 0 8000 AXIS_PTS_REF AX_shift_rpm /end AXIS_DESCR
/end CHARACTERISTIC
/begin CHARACTERISTIC SHIFT_1d87f0 "shift curve out-col @0x1d87f0 (max 1350)" CURVE 0x1d87fe RL_CURVE_U16 0 CM_RPM 0 8000
 /begin AXIS_DESCR COM_AXIS NO_INPUT_QUANTITY CM_RPM 7 0 8000 AXIS_PTS_REF AX_shift_rpm /end AXIS_DESCR
/end CHARACTERISTIC
/begin CHARACTERISTIC SHIFT_1d880c "shift curve out-col @0x1d880c (max 1350)" CURVE 0x1d881a RL_CURVE_U16 0 CM_RPM 0 8000
 /begin AXIS_DESCR COM_AXIS NO_INPUT_QUANTITY CM_RPM 7 0 8000 AXIS_PTS_REF AX_shift_rpm /end AXIS_DESCR
/end CHARACTERISTIC
/begin CHARACTERISTIC SHIFT_1d8828 "shift curve out-col @0x1d8828 (max 1350)" CURVE 0x1d8836 RL_CURVE_U16 0 CM_RPM 0 8000
 /begin AXIS_DESCR COM_AXIS NO_INPUT_QUANTITY CM_RPM 7 0 8000 AXIS_PTS_REF AX_shift_rpm /end AXIS_DESCR
/end CHARACTERISTIC
/begin CHARACTERISTIC SHIFT_1d8844 "shift curve out-col @0x1d8844 (max 7250)" CURVE 0x1d8852 RL_CURVE_U16 0 CM_RPM 0 8000
 /begin AXIS_DESCR COM_AXIS NO_INPUT_QUANTITY CM_RPM 7 0 8000 AXIS_PTS_REF AX_shift_rpm /end AXIS_DESCR
/end CHARACTERISTIC
/begin CHARACTERISTIC SHIFT_1d89d0 "shift curve out-col @0x1d89d0 (max 7250)" CURVE 0x1d89de RL_CURVE_U16 0 CM_RPM 0 8000
 /begin AXIS_DESCR COM_AXIS NO_INPUT_QUANTITY CM_RPM 7 0 8000 AXIS_PTS_REF AX_shift_rpm /end AXIS_DESCR
/end CHARACTERISTIC
/begin CHARACTERISTIC SHIFT_1d8b5c "shift curve out-col @0x1d8b5c (max 7250)" CURVE 0x1d8b6a RL_CURVE_U16 0 CM_RPM 0 8000
 /begin AXIS_DESCR COM_AXIS NO_INPUT_QUANTITY CM_RPM 7 0 8000 AXIS_PTS_REF AX_shift_rpm /end AXIS_DESCR
/end CHARACTERISTIC
/begin CHARACTERISTIC SHIFT_1d9000 "shift curve out-col @0x1d9000 (max 7250)" CURVE 0x1d900e RL_CURVE_U16 0 CM_RPM 0 8000
 /begin AXIS_DESCR COM_AXIS NO_INPUT_QUANTITY CM_RPM 7 0 8000 AXIS_PTS_REF AX_shift_rpm /end AXIS_DESCR
/end CHARACTERISTIC
/begin CHARACTERISTIC SHIFT_1d918c "shift curve out-col @0x1d918c (max 7250)" CURVE 0x1d919a RL_CURVE_U16 0 CM_RPM 0 8000
 /begin AXIS_DESCR COM_AXIS NO_INPUT_QUANTITY CM_RPM 7 0 8000 AXIS_PTS_REF AX_shift_rpm /end AXIS_DESCR
/end CHARACTERISTIC
/begin CHARACTERISTIC SHIFT_1d9614 "shift curve out-col @0x1d9614 (max 6000)" CURVE 0x1d9622 RL_CURVE_U16 0 CM_RPM 0 8000
 /begin AXIS_DESCR COM_AXIS NO_INPUT_QUANTITY CM_RPM 7 0 8000 AXIS_PTS_REF AX_shift_rpm /end AXIS_DESCR
/end CHARACTERISTIC
/begin CHARACTERISTIC SHIFT_1d9630 "shift curve out-col @0x1d9630 (max 7250)" CURVE 0x1d963e RL_CURVE_U16 0 CM_RPM 0 8000
 /begin AXIS_DESCR COM_AXIS NO_INPUT_QUANTITY CM_RPM 7 0 8000 AXIS_PTS_REF AX_shift_rpm /end AXIS_DESCR
/end CHARACTERISTIC
/begin CHARACTERISTIC SHIFT_1d97a0 "shift curve out-col @0x1d97a0 (max 6000)" CURVE 0x1d97ae RL_CURVE_U16 0 CM_RPM 0 8000
 /begin AXIS_DESCR COM_AXIS NO_INPUT_QUANTITY CM_RPM 7 0 8000 AXIS_PTS_REF AX_shift_rpm /end AXIS_DESCR
/end CHARACTERISTIC
/begin CHARACTERISTIC SHIFT_1d97bc "shift curve out-col @0x1d97bc (max 7250)" CURVE 0x1d97ca RL_CURVE_U16 0 CM_RPM 0 8000
 /begin AXIS_DESCR COM_AXIS NO_INPUT_QUANTITY CM_RPM 7 0 8000 AXIS_PTS_REF AX_shift_rpm /end AXIS_DESCR
/end CHARACTERISTIC
/begin CHARACTERISTIC SHIFT_1d992c "shift curve out-col @0x1d992c (max 6000)" CURVE 0x1d993a RL_CURVE_U16 0 CM_RPM 0 8000
 /begin AXIS_DESCR COM_AXIS NO_INPUT_QUANTITY CM_RPM 7 0 8000 AXIS_PTS_REF AX_shift_rpm /end AXIS_DESCR
/end CHARACTERISTIC
/begin CHARACTERISTIC SHIFT_1d9948 "shift curve out-col @0x1d9948 (max 7250)" CURVE 0x1d9956 RL_CURVE_U16 0 CM_RPM 0 8000
 /begin AXIS_DESCR COM_AXIS NO_INPUT_QUANTITY CM_RPM 7 0 8000 AXIS_PTS_REF AX_shift_rpm /end AXIS_DESCR
/end CHARACTERISTIC
/begin CHARACTERISTIC SHIFT_1d9ab8 "shift curve out-col @0x1d9ab8 (max 6000)" CURVE 0x1d9ac6 RL_CURVE_U16 0 CM_RPM 0 8000
 /begin AXIS_DESCR COM_AXIS NO_INPUT_QUANTITY CM_RPM 7 0 8000 AXIS_PTS_REF AX_shift_rpm /end AXIS_DESCR
/end CHARACTERISTIC
/begin CHARACTERISTIC SHIFT_1d9ad4 "shift curve out-col @0x1d9ad4 (max 7250)" CURVE 0x1d9ae2 RL_CURVE_U16 0 CM_RPM 0 8000
 /begin AXIS_DESCR COM_AXIS NO_INPUT_QUANTITY CM_RPM 7 0 8000 AXIS_PTS_REF AX_shift_rpm /end AXIS_DESCR
/end CHARACTERISTIC
/begin CHARACTERISTIC SHIFT_1dc364 "shift curve out-col @0x1dc364 (max 1580)" CURVE 0x1dc372 RL_CURVE_U16 0 CM_RPM 0 8000
 /begin AXIS_DESCR COM_AXIS NO_INPUT_QUANTITY CM_RPM 7 0 8000 AXIS_PTS_REF AX_shift_rpm /end AXIS_DESCR
/end CHARACTERISTIC
/begin CHARACTERISTIC SHIFT_1dc380 "shift curve out-col @0x1dc380 (max 1580)" CURVE 0x1dc38e RL_CURVE_U16 0 CM_RPM 0 8000
 /begin AXIS_DESCR COM_AXIS NO_INPUT_QUANTITY CM_RPM 7 0 8000 AXIS_PTS_REF AX_shift_rpm /end AXIS_DESCR
/end CHARACTERISTIC
/begin CHARACTERISTIC SHIFT_1dc39c "shift curve out-col @0x1dc39c (max 1580)" CURVE 0x1dc3aa RL_CURVE_U16 0 CM_RPM 0 8000
 /begin AXIS_DESCR COM_AXIS NO_INPUT_QUANTITY CM_RPM 7 0 8000 AXIS_PTS_REF AX_shift_rpm /end AXIS_DESCR
/end CHARACTERISTIC
/begin CHARACTERISTIC SHIFT_1dc3b8 "shift curve out-col @0x1dc3b8 (max 1750)" CURVE 0x1dc3c6 RL_CURVE_U16 0 CM_RPM 0 8000
 /begin AXIS_DESCR COM_AXIS NO_INPUT_QUANTITY CM_RPM 7 0 8000 AXIS_PTS_REF AX_shift_rpm /end AXIS_DESCR
/end CHARACTERISTIC
/begin CHARACTERISTIC SHIFT_1dc3d4 "shift curve out-col @0x1dc3d4 (max 6000)" CURVE 0x1dc3e2 RL_CURVE_U16 0 CM_RPM 0 8000
 /begin AXIS_DESCR COM_AXIS NO_INPUT_QUANTITY CM_RPM 7 0 8000 AXIS_PTS_REF AX_shift_rpm /end AXIS_DESCR
/end CHARACTERISTIC
/begin CHARACTERISTIC SHIFT_1dc3f0 "shift curve out-col @0x1dc3f0 (max 6000)" CURVE 0x1dc3fe RL_CURVE_U16 0 CM_RPM 0 8000
 /begin AXIS_DESCR COM_AXIS NO_INPUT_QUANTITY CM_RPM 7 0 8000 AXIS_PTS_REF AX_shift_rpm /end AXIS_DESCR
/end CHARACTERISTIC
/begin CHARACTERISTIC SHIFT_1dc40c "shift curve out-col @0x1dc40c (max 6000)" CURVE 0x1dc41a RL_CURVE_U16 0 CM_RPM 0 8000
 /begin AXIS_DESCR COM_AXIS NO_INPUT_QUANTITY CM_RPM 7 0 8000 AXIS_PTS_REF AX_shift_rpm /end AXIS_DESCR
/end CHARACTERISTIC
/begin CHARACTERISTIC SHIFT_1dc428 "shift curve out-col @0x1dc428 (max 6000)" CURVE 0x1dc436 RL_CURVE_U16 0 CM_RPM 0 8000
 /begin AXIS_DESCR COM_AXIS NO_INPUT_QUANTITY CM_RPM 7 0 8000 AXIS_PTS_REF AX_shift_rpm /end AXIS_DESCR
/end CHARACTERISTIC
/begin CHARACTERISTIC SHIFT_1dc444 "shift curve out-col @0x1dc444 (max 6000)" CURVE 0x1dc452 RL_CURVE_U16 0 CM_RPM 0 8000
 /begin AXIS_DESCR COM_AXIS NO_INPUT_QUANTITY CM_RPM 7 0 8000 AXIS_PTS_REF AX_shift_rpm /end AXIS_DESCR
/end CHARACTERISTIC
/begin CHARACTERISTIC SHIFT_1dc460 "shift curve out-col @0x1dc460 (max 6000)" CURVE 0x1dc46e RL_CURVE_U16 0 CM_RPM 0 8000
 /begin AXIS_DESCR COM_AXIS NO_INPUT_QUANTITY CM_RPM 7 0 8000 AXIS_PTS_REF AX_shift_rpm /end AXIS_DESCR
/end CHARACTERISTIC
/begin CHARACTERISTIC SHIFT_1dc47c "shift curve out-col @0x1dc47c (max 6000)" CURVE 0x1dc48a RL_CURVE_U16 0 CM_RPM 0 8000
 /begin AXIS_DESCR COM_AXIS NO_INPUT_QUANTITY CM_RPM 7 0 8000 AXIS_PTS_REF AX_shift_rpm /end AXIS_DESCR
/end CHARACTERISTIC
/begin CHARACTERISTIC SHIFT_1dc498 "shift curve out-col @0x1dc498 (max 7250)" CURVE 0x1dc4a6 RL_CURVE_U16 0 CM_RPM 0 8000
 /begin AXIS_DESCR COM_AXIS NO_INPUT_QUANTITY CM_RPM 7 0 8000 AXIS_PTS_REF AX_shift_rpm /end AXIS_DESCR
/end CHARACTERISTIC
/begin CHARACTERISTIC SHIFT_1dc4f0 "shift curve out-col @0x1dc4f0 (max 1580)" CURVE 0x1dc4fe RL_CURVE_U16 0 CM_RPM 0 8000
 /begin AXIS_DESCR COM_AXIS NO_INPUT_QUANTITY CM_RPM 7 0 8000 AXIS_PTS_REF AX_shift_rpm /end AXIS_DESCR
/end CHARACTERISTIC
/begin CHARACTERISTIC SHIFT_1dc50c "shift curve out-col @0x1dc50c (max 1580)" CURVE 0x1dc51a RL_CURVE_U16 0 CM_RPM 0 8000
 /begin AXIS_DESCR COM_AXIS NO_INPUT_QUANTITY CM_RPM 7 0 8000 AXIS_PTS_REF AX_shift_rpm /end AXIS_DESCR
/end CHARACTERISTIC
/begin CHARACTERISTIC SHIFT_1dc528 "shift curve out-col @0x1dc528 (max 1580)" CURVE 0x1dc536 RL_CURVE_U16 0 CM_RPM 0 8000
 /begin AXIS_DESCR COM_AXIS NO_INPUT_QUANTITY CM_RPM 7 0 8000 AXIS_PTS_REF AX_shift_rpm /end AXIS_DESCR
/end CHARACTERISTIC
/begin CHARACTERISTIC SHIFT_1dc544 "shift curve out-col @0x1dc544 (max 1750)" CURVE 0x1dc552 RL_CURVE_U16 0 CM_RPM 0 8000
 /begin AXIS_DESCR COM_AXIS NO_INPUT_QUANTITY CM_RPM 7 0 8000 AXIS_PTS_REF AX_shift_rpm /end AXIS_DESCR
/end CHARACTERISTIC
/begin CHARACTERISTIC SHIFT_1dc560 "shift curve out-col @0x1dc560 (max 6000)" CURVE 0x1dc56e RL_CURVE_U16 0 CM_RPM 0 8000
 /begin AXIS_DESCR COM_AXIS NO_INPUT_QUANTITY CM_RPM 7 0 8000 AXIS_PTS_REF AX_shift_rpm /end AXIS_DESCR
/end CHARACTERISTIC
/begin CHARACTERISTIC SHIFT_1dc57c "shift curve out-col @0x1dc57c (max 6000)" CURVE 0x1dc58a RL_CURVE_U16 0 CM_RPM 0 8000
 /begin AXIS_DESCR COM_AXIS NO_INPUT_QUANTITY CM_RPM 7 0 8000 AXIS_PTS_REF AX_shift_rpm /end AXIS_DESCR
/end CHARACTERISTIC
/begin CHARACTERISTIC SHIFT_1dc598 "shift curve out-col @0x1dc598 (max 6000)" CURVE 0x1dc5a6 RL_CURVE_U16 0 CM_RPM 0 8000
 /begin AXIS_DESCR COM_AXIS NO_INPUT_QUANTITY CM_RPM 7 0 8000 AXIS_PTS_REF AX_shift_rpm /end AXIS_DESCR
/end CHARACTERISTIC
/begin CHARACTERISTIC SHIFT_1dc5b4 "shift curve out-col @0x1dc5b4 (max 6000)" CURVE 0x1dc5c2 RL_CURVE_U16 0 CM_RPM 0 8000
 /begin AXIS_DESCR COM_AXIS NO_INPUT_QUANTITY CM_RPM 7 0 8000 AXIS_PTS_REF AX_shift_rpm /end AXIS_DESCR
/end CHARACTERISTIC
/begin CHARACTERISTIC SHIFT_1dc5d0 "shift curve out-col @0x1dc5d0 (max 6000)" CURVE 0x1dc5de RL_CURVE_U16 0 CM_RPM 0 8000
 /begin AXIS_DESCR COM_AXIS NO_INPUT_QUANTITY CM_RPM 7 0 8000 AXIS_PTS_REF AX_shift_rpm /end AXIS_DESCR
/end CHARACTERISTIC
/begin CHARACTERISTIC SHIFT_1dc5ec "shift curve out-col @0x1dc5ec (max 6000)" CURVE 0x1dc5fa RL_CURVE_U16 0 CM_RPM 0 8000
 /begin AXIS_DESCR COM_AXIS NO_INPUT_QUANTITY CM_RPM 7 0 8000 AXIS_PTS_REF AX_shift_rpm /end AXIS_DESCR
/end CHARACTERISTIC
/begin CHARACTERISTIC SHIFT_1dc608 "shift curve out-col @0x1dc608 (max 6000)" CURVE 0x1dc616 RL_CURVE_U16 0 CM_RPM 0 8000
 /begin AXIS_DESCR COM_AXIS NO_INPUT_QUANTITY CM_RPM 7 0 8000 AXIS_PTS_REF AX_shift_rpm /end AXIS_DESCR
/end CHARACTERISTIC
/begin CHARACTERISTIC SHIFT_1dc624 "shift curve out-col @0x1dc624 (max 7250)" CURVE 0x1dc632 RL_CURVE_U16 0 CM_RPM 0 8000
 /begin AXIS_DESCR COM_AXIS NO_INPUT_QUANTITY CM_RPM 7 0 8000 AXIS_PTS_REF AX_shift_rpm /end AXIS_DESCR
/end CHARACTERISTIC
/begin CHARACTERISTIC SHIFT_1dc67c "shift curve out-col @0x1dc67c (max 1580)" CURVE 0x1dc68a RL_CURVE_U16 0 CM_RPM 0 8000
 /begin AXIS_DESCR COM_AXIS NO_INPUT_QUANTITY CM_RPM 7 0 8000 AXIS_PTS_REF AX_shift_rpm /end AXIS_DESCR
/end CHARACTERISTIC
/begin CHARACTERISTIC SHIFT_1dc698 "shift curve out-col @0x1dc698 (max 1580)" CURVE 0x1dc6a6 RL_CURVE_U16 0 CM_RPM 0 8000
 /begin AXIS_DESCR COM_AXIS NO_INPUT_QUANTITY CM_RPM 7 0 8000 AXIS_PTS_REF AX_shift_rpm /end AXIS_DESCR
/end CHARACTERISTIC
/begin CHARACTERISTIC SHIFT_1dc6b4 "shift curve out-col @0x1dc6b4 (max 1580)" CURVE 0x1dc6c2 RL_CURVE_U16 0 CM_RPM 0 8000
 /begin AXIS_DESCR COM_AXIS NO_INPUT_QUANTITY CM_RPM 7 0 8000 AXIS_PTS_REF AX_shift_rpm /end AXIS_DESCR
/end CHARACTERISTIC
/begin CHARACTERISTIC SHIFT_1dc6d0 "shift curve out-col @0x1dc6d0 (max 1750)" CURVE 0x1dc6de RL_CURVE_U16 0 CM_RPM 0 8000
 /begin AXIS_DESCR COM_AXIS NO_INPUT_QUANTITY CM_RPM 7 0 8000 AXIS_PTS_REF AX_shift_rpm /end AXIS_DESCR
/end CHARACTERISTIC
/begin CHARACTERISTIC SHIFT_1dc6ec "shift curve out-col @0x1dc6ec (max 6000)" CURVE 0x1dc6fa RL_CURVE_U16 0 CM_RPM 0 8000
 /begin AXIS_DESCR COM_AXIS NO_INPUT_QUANTITY CM_RPM 7 0 8000 AXIS_PTS_REF AX_shift_rpm /end AXIS_DESCR
/end CHARACTERISTIC
/begin CHARACTERISTIC SHIFT_1dc708 "shift curve out-col @0x1dc708 (max 6000)" CURVE 0x1dc716 RL_CURVE_U16 0 CM_RPM 0 8000
 /begin AXIS_DESCR COM_AXIS NO_INPUT_QUANTITY CM_RPM 7 0 8000 AXIS_PTS_REF AX_shift_rpm /end AXIS_DESCR
/end CHARACTERISTIC
/begin CHARACTERISTIC SHIFT_1dc724 "shift curve out-col @0x1dc724 (max 6000)" CURVE 0x1dc732 RL_CURVE_U16 0 CM_RPM 0 8000
 /begin AXIS_DESCR COM_AXIS NO_INPUT_QUANTITY CM_RPM 7 0 8000 AXIS_PTS_REF AX_shift_rpm /end AXIS_DESCR
/end CHARACTERISTIC
/begin CHARACTERISTIC SHIFT_1dc740 "shift curve out-col @0x1dc740 (max 6000)" CURVE 0x1dc74e RL_CURVE_U16 0 CM_RPM 0 8000
 /begin AXIS_DESCR COM_AXIS NO_INPUT_QUANTITY CM_RPM 7 0 8000 AXIS_PTS_REF AX_shift_rpm /end AXIS_DESCR
/end CHARACTERISTIC
/begin CHARACTERISTIC SHIFT_1dc75c "shift curve out-col @0x1dc75c (max 6000)" CURVE 0x1dc76a RL_CURVE_U16 0 CM_RPM 0 8000
 /begin AXIS_DESCR COM_AXIS NO_INPUT_QUANTITY CM_RPM 7 0 8000 AXIS_PTS_REF AX_shift_rpm /end AXIS_DESCR
/end CHARACTERISTIC
/begin CHARACTERISTIC SHIFT_1dc778 "shift curve out-col @0x1dc778 (max 6000)" CURVE 0x1dc786 RL_CURVE_U16 0 CM_RPM 0 8000
 /begin AXIS_DESCR COM_AXIS NO_INPUT_QUANTITY CM_RPM 7 0 8000 AXIS_PTS_REF AX_shift_rpm /end AXIS_DESCR
/end CHARACTERISTIC
/begin CHARACTERISTIC SHIFT_1dc794 "shift curve out-col @0x1dc794 (max 6000)" CURVE 0x1dc7a2 RL_CURVE_U16 0 CM_RPM 0 8000
 /begin AXIS_DESCR COM_AXIS NO_INPUT_QUANTITY CM_RPM 7 0 8000 AXIS_PTS_REF AX_shift_rpm /end AXIS_DESCR
/end CHARACTERISTIC
/begin CHARACTERISTIC SHIFT_1dc7b0 "shift curve out-col @0x1dc7b0 (max 7250)" CURVE 0x1dc7be RL_CURVE_U16 0 CM_RPM 0 8000
 /begin AXIS_DESCR COM_AXIS NO_INPUT_QUANTITY CM_RPM 7 0 8000 AXIS_PTS_REF AX_shift_rpm /end AXIS_DESCR
/end CHARACTERISTIC
/begin CHARACTERISTIC SHIFT_1dc808 "shift curve out-col @0x1dc808 (max 1580)" CURVE 0x1dc816 RL_CURVE_U16 0 CM_RPM 0 8000
 /begin AXIS_DESCR COM_AXIS NO_INPUT_QUANTITY CM_RPM 7 0 8000 AXIS_PTS_REF AX_shift_rpm /end AXIS_DESCR
/end CHARACTERISTIC
/begin CHARACTERISTIC SHIFT_1dc824 "shift curve out-col @0x1dc824 (max 1580)" CURVE 0x1dc832 RL_CURVE_U16 0 CM_RPM 0 8000
 /begin AXIS_DESCR COM_AXIS NO_INPUT_QUANTITY CM_RPM 7 0 8000 AXIS_PTS_REF AX_shift_rpm /end AXIS_DESCR
/end CHARACTERISTIC
/begin CHARACTERISTIC SHIFT_1dc840 "shift curve out-col @0x1dc840 (max 1580)" CURVE 0x1dc84e RL_CURVE_U16 0 CM_RPM 0 8000
 /begin AXIS_DESCR COM_AXIS NO_INPUT_QUANTITY CM_RPM 7 0 8000 AXIS_PTS_REF AX_shift_rpm /end AXIS_DESCR
/end CHARACTERISTIC
/begin CHARACTERISTIC SHIFT_1dc85c "shift curve out-col @0x1dc85c (max 1750)" CURVE 0x1dc86a RL_CURVE_U16 0 CM_RPM 0 8000
 /begin AXIS_DESCR COM_AXIS NO_INPUT_QUANTITY CM_RPM 7 0 8000 AXIS_PTS_REF AX_shift_rpm /end AXIS_DESCR
/end CHARACTERISTIC
/begin CHARACTERISTIC SHIFT_1dc878 "shift curve out-col @0x1dc878 (max 6000)" CURVE 0x1dc886 RL_CURVE_U16 0 CM_RPM 0 8000
 /begin AXIS_DESCR COM_AXIS NO_INPUT_QUANTITY CM_RPM 7 0 8000 AXIS_PTS_REF AX_shift_rpm /end AXIS_DESCR
/end CHARACTERISTIC
/begin CHARACTERISTIC SHIFT_1dc894 "shift curve out-col @0x1dc894 (max 6000)" CURVE 0x1dc8a2 RL_CURVE_U16 0 CM_RPM 0 8000
 /begin AXIS_DESCR COM_AXIS NO_INPUT_QUANTITY CM_RPM 7 0 8000 AXIS_PTS_REF AX_shift_rpm /end AXIS_DESCR
/end CHARACTERISTIC
/begin CHARACTERISTIC SHIFT_1dc8b0 "shift curve out-col @0x1dc8b0 (max 6000)" CURVE 0x1dc8be RL_CURVE_U16 0 CM_RPM 0 8000
 /begin AXIS_DESCR COM_AXIS NO_INPUT_QUANTITY CM_RPM 7 0 8000 AXIS_PTS_REF AX_shift_rpm /end AXIS_DESCR
/end CHARACTERISTIC
/begin CHARACTERISTIC SHIFT_1dc8cc "shift curve out-col @0x1dc8cc (max 6000)" CURVE 0x1dc8da RL_CURVE_U16 0 CM_RPM 0 8000
 /begin AXIS_DESCR COM_AXIS NO_INPUT_QUANTITY CM_RPM 7 0 8000 AXIS_PTS_REF AX_shift_rpm /end AXIS_DESCR
/end CHARACTERISTIC
/begin CHARACTERISTIC SHIFT_1dc8e8 "shift curve out-col @0x1dc8e8 (max 6000)" CURVE 0x1dc8f6 RL_CURVE_U16 0 CM_RPM 0 8000
 /begin AXIS_DESCR COM_AXIS NO_INPUT_QUANTITY CM_RPM 7 0 8000 AXIS_PTS_REF AX_shift_rpm /end AXIS_DESCR
/end CHARACTERISTIC
/begin CHARACTERISTIC SHIFT_1dc904 "shift curve out-col @0x1dc904 (max 6000)" CURVE 0x1dc912 RL_CURVE_U16 0 CM_RPM 0 8000
 /begin AXIS_DESCR COM_AXIS NO_INPUT_QUANTITY CM_RPM 7 0 8000 AXIS_PTS_REF AX_shift_rpm /end AXIS_DESCR
/end CHARACTERISTIC
/begin CHARACTERISTIC SHIFT_1dc920 "shift curve out-col @0x1dc920 (max 6000)" CURVE 0x1dc92e RL_CURVE_U16 0 CM_RPM 0 8000
 /begin AXIS_DESCR COM_AXIS NO_INPUT_QUANTITY CM_RPM 7 0 8000 AXIS_PTS_REF AX_shift_rpm /end AXIS_DESCR
/end CHARACTERISTIC
/begin CHARACTERISTIC SHIFT_1dc93c "shift curve out-col @0x1dc93c (max 7250)" CURVE 0x1dc94a RL_CURVE_U16 0 CM_RPM 0 8000
 /begin AXIS_DESCR COM_AXIS NO_INPUT_QUANTITY CM_RPM 7 0 8000 AXIS_PTS_REF AX_shift_rpm /end AXIS_DESCR
/end CHARACTERISTIC
/begin CHARACTERISTIC SHIFT_1dc994 "shift curve out-col @0x1dc994 (max 2510)" CURVE 0x1dc9a2 RL_CURVE_U16 0 CM_RPM 0 8000
 /begin AXIS_DESCR COM_AXIS NO_INPUT_QUANTITY CM_RPM 7 0 8000 AXIS_PTS_REF AX_shift_rpm /end AXIS_DESCR
/end CHARACTERISTIC
/begin CHARACTERISTIC SHIFT_1dc9b0 "shift curve out-col @0x1dc9b0 (max 2510)" CURVE 0x1dc9be RL_CURVE_U16 0 CM_RPM 0 8000
 /begin AXIS_DESCR COM_AXIS NO_INPUT_QUANTITY CM_RPM 7 0 8000 AXIS_PTS_REF AX_shift_rpm /end AXIS_DESCR
/end CHARACTERISTIC
/begin CHARACTERISTIC SHIFT_1dc9cc "shift curve out-col @0x1dc9cc (max 2510)" CURVE 0x1dc9da RL_CURVE_U16 0 CM_RPM 0 8000
 /begin AXIS_DESCR COM_AXIS NO_INPUT_QUANTITY CM_RPM 7 0 8000 AXIS_PTS_REF AX_shift_rpm /end AXIS_DESCR
/end CHARACTERISTIC
/begin CHARACTERISTIC SHIFT_1dc9e8 "shift curve out-col @0x1dc9e8 (max 2510)" CURVE 0x1dc9f6 RL_CURVE_U16 0 CM_RPM 0 8000
 /begin AXIS_DESCR COM_AXIS NO_INPUT_QUANTITY CM_RPM 7 0 8000 AXIS_PTS_REF AX_shift_rpm /end AXIS_DESCR
/end CHARACTERISTIC
/begin CHARACTERISTIC SHIFT_1dca04 "shift curve out-col @0x1dca04 (max 7250)" CURVE 0x1dca12 RL_CURVE_U16 0 CM_RPM 0 8000
 /begin AXIS_DESCR COM_AXIS NO_INPUT_QUANTITY CM_RPM 7 0 8000 AXIS_PTS_REF AX_shift_rpm /end AXIS_DESCR
/end CHARACTERISTIC
/begin CHARACTERISTIC SHIFT_1dca20 "shift curve out-col @0x1dca20 (max 7250)" CURVE 0x1dca2e RL_CURVE_U16 0 CM_RPM 0 8000
 /begin AXIS_DESCR COM_AXIS NO_INPUT_QUANTITY CM_RPM 7 0 8000 AXIS_PTS_REF AX_shift_rpm /end AXIS_DESCR
/end CHARACTERISTIC
/begin CHARACTERISTIC SHIFT_1dca3c "shift curve out-col @0x1dca3c (max 7250)" CURVE 0x1dca4a RL_CURVE_U16 0 CM_RPM 0 8000
 /begin AXIS_DESCR COM_AXIS NO_INPUT_QUANTITY CM_RPM 7 0 8000 AXIS_PTS_REF AX_shift_rpm /end AXIS_DESCR
/end CHARACTERISTIC
/begin CHARACTERISTIC SHIFT_1dca58 "shift curve out-col @0x1dca58 (max 7250)" CURVE 0x1dca66 RL_CURVE_U16 0 CM_RPM 0 8000
 /begin AXIS_DESCR COM_AXIS NO_INPUT_QUANTITY CM_RPM 7 0 8000 AXIS_PTS_REF AX_shift_rpm /end AXIS_DESCR
/end CHARACTERISTIC
/begin CHARACTERISTIC SHIFT_1dca74 "shift curve out-col @0x1dca74 (max 7250)" CURVE 0x1dca82 RL_CURVE_U16 0 CM_RPM 0 8000
 /begin AXIS_DESCR COM_AXIS NO_INPUT_QUANTITY CM_RPM 7 0 8000 AXIS_PTS_REF AX_shift_rpm /end AXIS_DESCR
/end CHARACTERISTIC
/begin CHARACTERISTIC SHIFT_1dca90 "shift curve out-col @0x1dca90 (max 7250)" CURVE 0x1dca9e RL_CURVE_U16 0 CM_RPM 0 8000
 /begin AXIS_DESCR COM_AXIS NO_INPUT_QUANTITY CM_RPM 7 0 8000 AXIS_PTS_REF AX_shift_rpm /end AXIS_DESCR
/end CHARACTERISTIC
/begin CHARACTERISTIC SHIFT_1dcaac "shift curve out-col @0x1dcaac (max 7250)" CURVE 0x1dcaba RL_CURVE_U16 0 CM_RPM 0 8000
 /begin AXIS_DESCR COM_AXIS NO_INPUT_QUANTITY CM_RPM 7 0 8000 AXIS_PTS_REF AX_shift_rpm /end AXIS_DESCR
/end CHARACTERISTIC
/begin CHARACTERISTIC SHIFT_1dcac8 "shift curve out-col @0x1dcac8 (max 7250)" CURVE 0x1dcad6 RL_CURVE_U16 0 CM_RPM 0 8000
 /begin AXIS_DESCR COM_AXIS NO_INPUT_QUANTITY CM_RPM 7 0 8000 AXIS_PTS_REF AX_shift_rpm /end AXIS_DESCR
/end CHARACTERISTIC
/begin CHARACTERISTIC SHIFT_1dcb20 "shift curve out-col @0x1dcb20 (max 2510)" CURVE 0x1dcb2e RL_CURVE_U16 0 CM_RPM 0 8000
 /begin AXIS_DESCR COM_AXIS NO_INPUT_QUANTITY CM_RPM 7 0 8000 AXIS_PTS_REF AX_shift_rpm /end AXIS_DESCR
/end CHARACTERISTIC
/begin CHARACTERISTIC SHIFT_1dcb3c "shift curve out-col @0x1dcb3c (max 2510)" CURVE 0x1dcb4a RL_CURVE_U16 0 CM_RPM 0 8000
 /begin AXIS_DESCR COM_AXIS NO_INPUT_QUANTITY CM_RPM 7 0 8000 AXIS_PTS_REF AX_shift_rpm /end AXIS_DESCR
/end CHARACTERISTIC
/begin CHARACTERISTIC SHIFT_1dcb58 "shift curve out-col @0x1dcb58 (max 2510)" CURVE 0x1dcb66 RL_CURVE_U16 0 CM_RPM 0 8000
 /begin AXIS_DESCR COM_AXIS NO_INPUT_QUANTITY CM_RPM 7 0 8000 AXIS_PTS_REF AX_shift_rpm /end AXIS_DESCR
/end CHARACTERISTIC
/begin CHARACTERISTIC SHIFT_1dcb74 "shift curve out-col @0x1dcb74 (max 2510)" CURVE 0x1dcb82 RL_CURVE_U16 0 CM_RPM 0 8000
 /begin AXIS_DESCR COM_AXIS NO_INPUT_QUANTITY CM_RPM 7 0 8000 AXIS_PTS_REF AX_shift_rpm /end AXIS_DESCR
/end CHARACTERISTIC
/begin CHARACTERISTIC SHIFT_1dcb90 "shift curve out-col @0x1dcb90 (max 7250)" CURVE 0x1dcb9e RL_CURVE_U16 0 CM_RPM 0 8000
 /begin AXIS_DESCR COM_AXIS NO_INPUT_QUANTITY CM_RPM 7 0 8000 AXIS_PTS_REF AX_shift_rpm /end AXIS_DESCR
/end CHARACTERISTIC
/begin CHARACTERISTIC SHIFT_1dcbac "shift curve out-col @0x1dcbac (max 7250)" CURVE 0x1dcbba RL_CURVE_U16 0 CM_RPM 0 8000
 /begin AXIS_DESCR COM_AXIS NO_INPUT_QUANTITY CM_RPM 7 0 8000 AXIS_PTS_REF AX_shift_rpm /end AXIS_DESCR
/end CHARACTERISTIC
/begin CHARACTERISTIC SHIFT_1dcbc8 "shift curve out-col @0x1dcbc8 (max 7250)" CURVE 0x1dcbd6 RL_CURVE_U16 0 CM_RPM 0 8000
 /begin AXIS_DESCR COM_AXIS NO_INPUT_QUANTITY CM_RPM 7 0 8000 AXIS_PTS_REF AX_shift_rpm /end AXIS_DESCR
/end CHARACTERISTIC
/begin CHARACTERISTIC SHIFT_1dcbe4 "shift curve out-col @0x1dcbe4 (max 7250)" CURVE 0x1dcbf2 RL_CURVE_U16 0 CM_RPM 0 8000
 /begin AXIS_DESCR COM_AXIS NO_INPUT_QUANTITY CM_RPM 7 0 8000 AXIS_PTS_REF AX_shift_rpm /end AXIS_DESCR
/end CHARACTERISTIC
/begin CHARACTERISTIC SHIFT_1dcc00 "shift curve out-col @0x1dcc00 (max 7250)" CURVE 0x1dcc0e RL_CURVE_U16 0 CM_RPM 0 8000
 /begin AXIS_DESCR COM_AXIS NO_INPUT_QUANTITY CM_RPM 7 0 8000 AXIS_PTS_REF AX_shift_rpm /end AXIS_DESCR
/end CHARACTERISTIC
/begin CHARACTERISTIC SHIFT_1dcc1c "shift curve out-col @0x1dcc1c (max 7250)" CURVE 0x1dcc2a RL_CURVE_U16 0 CM_RPM 0 8000
 /begin AXIS_DESCR COM_AXIS NO_INPUT_QUANTITY CM_RPM 7 0 8000 AXIS_PTS_REF AX_shift_rpm /end AXIS_DESCR
/end CHARACTERISTIC
/begin CHARACTERISTIC SHIFT_1dcc38 "shift curve out-col @0x1dcc38 (max 7250)" CURVE 0x1dcc46 RL_CURVE_U16 0 CM_RPM 0 8000
 /begin AXIS_DESCR COM_AXIS NO_INPUT_QUANTITY CM_RPM 7 0 8000 AXIS_PTS_REF AX_shift_rpm /end AXIS_DESCR
/end CHARACTERISTIC
/begin CHARACTERISTIC SHIFT_1dcc54 "shift curve out-col @0x1dcc54 (max 7250)" CURVE 0x1dcc62 RL_CURVE_U16 0 CM_RPM 0 8000
 /begin AXIS_DESCR COM_AXIS NO_INPUT_QUANTITY CM_RPM 7 0 8000 AXIS_PTS_REF AX_shift_rpm /end AXIS_DESCR
/end CHARACTERISTIC
/begin CHARACTERISTIC SHIFT_1dccac "shift curve out-col @0x1dccac (max 2400)" CURVE 0x1dccba RL_CURVE_U16 0 CM_RPM 0 8000
 /begin AXIS_DESCR COM_AXIS NO_INPUT_QUANTITY CM_RPM 7 0 8000 AXIS_PTS_REF AX_shift_rpm /end AXIS_DESCR
/end CHARACTERISTIC
/begin CHARACTERISTIC SHIFT_1dccc8 "shift curve out-col @0x1dccc8 (max 2400)" CURVE 0x1dccd6 RL_CURVE_U16 0 CM_RPM 0 8000
 /begin AXIS_DESCR COM_AXIS NO_INPUT_QUANTITY CM_RPM 7 0 8000 AXIS_PTS_REF AX_shift_rpm /end AXIS_DESCR
/end CHARACTERISTIC
/begin CHARACTERISTIC SHIFT_1dcce4 "shift curve out-col @0x1dcce4 (max 2400)" CURVE 0x1dccf2 RL_CURVE_U16 0 CM_RPM 0 8000
 /begin AXIS_DESCR COM_AXIS NO_INPUT_QUANTITY CM_RPM 7 0 8000 AXIS_PTS_REF AX_shift_rpm /end AXIS_DESCR
/end CHARACTERISTIC
/begin CHARACTERISTIC SHIFT_1dcd00 "shift curve out-col @0x1dcd00 (max 2400)" CURVE 0x1dcd0e RL_CURVE_U16 0 CM_RPM 0 8000
 /begin AXIS_DESCR COM_AXIS NO_INPUT_QUANTITY CM_RPM 7 0 8000 AXIS_PTS_REF AX_shift_rpm /end AXIS_DESCR
/end CHARACTERISTIC
/begin CHARACTERISTIC SHIFT_1dcd1c "shift curve out-col @0x1dcd1c (max 7250)" CURVE 0x1dcd2a RL_CURVE_U16 0 CM_RPM 0 8000
 /begin AXIS_DESCR COM_AXIS NO_INPUT_QUANTITY CM_RPM 7 0 8000 AXIS_PTS_REF AX_shift_rpm /end AXIS_DESCR
/end CHARACTERISTIC
/begin CHARACTERISTIC SHIFT_1dcd38 "shift curve out-col @0x1dcd38 (max 7250)" CURVE 0x1dcd46 RL_CURVE_U16 0 CM_RPM 0 8000
 /begin AXIS_DESCR COM_AXIS NO_INPUT_QUANTITY CM_RPM 7 0 8000 AXIS_PTS_REF AX_shift_rpm /end AXIS_DESCR
/end CHARACTERISTIC
/begin CHARACTERISTIC SHIFT_1dcd54 "shift curve out-col @0x1dcd54 (max 7250)" CURVE 0x1dcd62 RL_CURVE_U16 0 CM_RPM 0 8000
 /begin AXIS_DESCR COM_AXIS NO_INPUT_QUANTITY CM_RPM 7 0 8000 AXIS_PTS_REF AX_shift_rpm /end AXIS_DESCR
/end CHARACTERISTIC
/begin CHARACTERISTIC SHIFT_1dcd70 "shift curve out-col @0x1dcd70 (max 7250)" CURVE 0x1dcd7e RL_CURVE_U16 0 CM_RPM 0 8000
 /begin AXIS_DESCR COM_AXIS NO_INPUT_QUANTITY CM_RPM 7 0 8000 AXIS_PTS_REF AX_shift_rpm /end AXIS_DESCR
/end CHARACTERISTIC
/begin CHARACTERISTIC SHIFT_1dcd8c "shift curve out-col @0x1dcd8c (max 7250)" CURVE 0x1dcd9a RL_CURVE_U16 0 CM_RPM 0 8000
 /begin AXIS_DESCR COM_AXIS NO_INPUT_QUANTITY CM_RPM 7 0 8000 AXIS_PTS_REF AX_shift_rpm /end AXIS_DESCR
/end CHARACTERISTIC
/begin CHARACTERISTIC SHIFT_1dcda8 "shift curve out-col @0x1dcda8 (max 7250)" CURVE 0x1dcdb6 RL_CURVE_U16 0 CM_RPM 0 8000
 /begin AXIS_DESCR COM_AXIS NO_INPUT_QUANTITY CM_RPM 7 0 8000 AXIS_PTS_REF AX_shift_rpm /end AXIS_DESCR
/end CHARACTERISTIC
/begin CHARACTERISTIC SHIFT_1dcdc4 "shift curve out-col @0x1dcdc4 (max 7250)" CURVE 0x1dcdd2 RL_CURVE_U16 0 CM_RPM 0 8000
 /begin AXIS_DESCR COM_AXIS NO_INPUT_QUANTITY CM_RPM 7 0 8000 AXIS_PTS_REF AX_shift_rpm /end AXIS_DESCR
/end CHARACTERISTIC
/begin CHARACTERISTIC SHIFT_1dcde0 "shift curve out-col @0x1dcde0 (max 7250)" CURVE 0x1dcdee RL_CURVE_U16 0 CM_RPM 0 8000
 /begin AXIS_DESCR COM_AXIS NO_INPUT_QUANTITY CM_RPM 7 0 8000 AXIS_PTS_REF AX_shift_rpm /end AXIS_DESCR
/end CHARACTERISTIC
/begin CHARACTERISTIC SHIFT_1dce38 "shift curve out-col @0x1dce38 (max 2400)" CURVE 0x1dce46 RL_CURVE_U16 0 CM_RPM 0 8000
 /begin AXIS_DESCR COM_AXIS NO_INPUT_QUANTITY CM_RPM 7 0 8000 AXIS_PTS_REF AX_shift_rpm /end AXIS_DESCR
/end CHARACTERISTIC
/begin CHARACTERISTIC SHIFT_1dce54 "shift curve out-col @0x1dce54 (max 2400)" CURVE 0x1dce62 RL_CURVE_U16 0 CM_RPM 0 8000
 /begin AXIS_DESCR COM_AXIS NO_INPUT_QUANTITY CM_RPM 7 0 8000 AXIS_PTS_REF AX_shift_rpm /end AXIS_DESCR
/end CHARACTERISTIC
/begin CHARACTERISTIC SHIFT_1dce70 "shift curve out-col @0x1dce70 (max 2400)" CURVE 0x1dce7e RL_CURVE_U16 0 CM_RPM 0 8000
 /begin AXIS_DESCR COM_AXIS NO_INPUT_QUANTITY CM_RPM 7 0 8000 AXIS_PTS_REF AX_shift_rpm /end AXIS_DESCR
/end CHARACTERISTIC
/begin CHARACTERISTIC SHIFT_1dce8c "shift curve out-col @0x1dce8c (max 2400)" CURVE 0x1dce9a RL_CURVE_U16 0 CM_RPM 0 8000
 /begin AXIS_DESCR COM_AXIS NO_INPUT_QUANTITY CM_RPM 7 0 8000 AXIS_PTS_REF AX_shift_rpm /end AXIS_DESCR
/end CHARACTERISTIC
/begin CHARACTERISTIC SHIFT_1dcea8 "shift curve out-col @0x1dcea8 (max 7250)" CURVE 0x1dceb6 RL_CURVE_U16 0 CM_RPM 0 8000
 /begin AXIS_DESCR COM_AXIS NO_INPUT_QUANTITY CM_RPM 7 0 8000 AXIS_PTS_REF AX_shift_rpm /end AXIS_DESCR
/end CHARACTERISTIC
/begin CHARACTERISTIC SHIFT_1dcec4 "shift curve out-col @0x1dcec4 (max 7250)" CURVE 0x1dced2 RL_CURVE_U16 0 CM_RPM 0 8000
 /begin AXIS_DESCR COM_AXIS NO_INPUT_QUANTITY CM_RPM 7 0 8000 AXIS_PTS_REF AX_shift_rpm /end AXIS_DESCR
/end CHARACTERISTIC
/begin CHARACTERISTIC SHIFT_1dcee0 "shift curve out-col @0x1dcee0 (max 7250)" CURVE 0x1dceee RL_CURVE_U16 0 CM_RPM 0 8000
 /begin AXIS_DESCR COM_AXIS NO_INPUT_QUANTITY CM_RPM 7 0 8000 AXIS_PTS_REF AX_shift_rpm /end AXIS_DESCR
/end CHARACTERISTIC
/begin CHARACTERISTIC SHIFT_1dcefc "shift curve out-col @0x1dcefc (max 7250)" CURVE 0x1dcf0a RL_CURVE_U16 0 CM_RPM 0 8000
 /begin AXIS_DESCR COM_AXIS NO_INPUT_QUANTITY CM_RPM 7 0 8000 AXIS_PTS_REF AX_shift_rpm /end AXIS_DESCR
/end CHARACTERISTIC
/begin CHARACTERISTIC SHIFT_1dcf18 "shift curve out-col @0x1dcf18 (max 7250)" CURVE 0x1dcf26 RL_CURVE_U16 0 CM_RPM 0 8000
 /begin AXIS_DESCR COM_AXIS NO_INPUT_QUANTITY CM_RPM 7 0 8000 AXIS_PTS_REF AX_shift_rpm /end AXIS_DESCR
/end CHARACTERISTIC
/begin CHARACTERISTIC SHIFT_1dcf34 "shift curve out-col @0x1dcf34 (max 7250)" CURVE 0x1dcf42 RL_CURVE_U16 0 CM_RPM 0 8000
 /begin AXIS_DESCR COM_AXIS NO_INPUT_QUANTITY CM_RPM 7 0 8000 AXIS_PTS_REF AX_shift_rpm /end AXIS_DESCR
/end CHARACTERISTIC
/begin CHARACTERISTIC SHIFT_1dcf50 "shift curve out-col @0x1dcf50 (max 7250)" CURVE 0x1dcf5e RL_CURVE_U16 0 CM_RPM 0 8000
 /begin AXIS_DESCR COM_AXIS NO_INPUT_QUANTITY CM_RPM 7 0 8000 AXIS_PTS_REF AX_shift_rpm /end AXIS_DESCR
/end CHARACTERISTIC
/begin CHARACTERISTIC SHIFT_1dcf6c "shift curve out-col @0x1dcf6c (max 7250)" CURVE 0x1dcf7a RL_CURVE_U16 0 CM_RPM 0 8000
 /begin AXIS_DESCR COM_AXIS NO_INPUT_QUANTITY CM_RPM 7 0 8000 AXIS_PTS_REF AX_shift_rpm /end AXIS_DESCR
/end CHARACTERISTIC
/begin CHARACTERISTIC SHIFT_1dd0f8 "shift curve out-col @0x1dd0f8 (max 7250)" CURVE 0x1dd106 RL_CURVE_U16 0 CM_RPM 0 8000
 /begin AXIS_DESCR COM_AXIS NO_INPUT_QUANTITY CM_RPM 7 0 8000 AXIS_PTS_REF AX_shift_rpm /end AXIS_DESCR
/end CHARACTERISTIC
/begin CHARACTERISTIC SHIFT_1dd284 "shift curve out-col @0x1dd284 (max 7250)" CURVE 0x1dd292 RL_CURVE_U16 0 CM_RPM 0 8000
 /begin AXIS_DESCR COM_AXIS NO_INPUT_QUANTITY CM_RPM 7 0 8000 AXIS_PTS_REF AX_shift_rpm /end AXIS_DESCR
/end CHARACTERISTIC
/begin CHARACTERISTIC SHIFT_1dd410 "shift curve out-col @0x1dd410 (max 7250)" CURVE 0x1dd41e RL_CURVE_U16 0 CM_RPM 0 8000
 /begin AXIS_DESCR COM_AXIS NO_INPUT_QUANTITY CM_RPM 7 0 8000 AXIS_PTS_REF AX_shift_rpm /end AXIS_DESCR
/end CHARACTERISTIC
/begin CHARACTERISTIC SHIFT_1dd59c "shift curve out-col @0x1dd59c (max 7250)" CURVE 0x1dd5aa RL_CURVE_U16 0 CM_RPM 0 8000
 /begin AXIS_DESCR COM_AXIS NO_INPUT_QUANTITY CM_RPM 7 0 8000 AXIS_PTS_REF AX_shift_rpm /end AXIS_DESCR
/end CHARACTERISTIC
/begin CHARACTERISTIC SHIFT_1dd728 "shift curve out-col @0x1dd728 (max 7250)" CURVE 0x1dd736 RL_CURVE_U16 0 CM_RPM 0 8000
 /begin AXIS_DESCR COM_AXIS NO_INPUT_QUANTITY CM_RPM 7 0 8000 AXIS_PTS_REF AX_shift_rpm /end AXIS_DESCR
/end CHARACTERISTIC
/begin CHARACTERISTIC SHIFT_1dd8b4 "shift curve out-col @0x1dd8b4 (max 7250)" CURVE 0x1dd8c2 RL_CURVE_U16 0 CM_RPM 0 8000
 /begin AXIS_DESCR COM_AXIS NO_INPUT_QUANTITY CM_RPM 7 0 8000 AXIS_PTS_REF AX_shift_rpm /end AXIS_DESCR
/end CHARACTERISTIC
/begin GROUP CAN "CAN RX/TX buffers" ROOT /end GROUP
/begin GROUP TorqueLimit "input-torque-limit Kennfelder" ROOT /end GROUP
/begin GROUP ShiftPoints "shift-curve output columns" ROOT /end GROUP
/begin GROUP Charisma "drive-program (echo-only on this SW)" ROOT /end GROUP
/end MODULE
/end PROJECT
